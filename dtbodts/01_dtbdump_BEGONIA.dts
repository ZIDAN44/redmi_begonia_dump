/dts-v1/;

/ {
	compatible = "mediatek,MT6785";
	model = "BEGONIA";

	__fixups__ {
		accdet = "/fragment@5:target:0";
		auxadc = "/fragment@16:target:0", "/fragment@17/__overlay__:io-channels:0";
		charger = "/fragment@65:target:0";
		chosen = "/fragment@1:target:0";
		consys = "/fragment@13:target:0";
		dsi_te = "/fragment@36:target:0";
		goodix_fp = "/fragment@35:target:0", "/fragment@55:target:0";
		gpio = "/fragment@30:target:0";
		gpio_usage_mapping = "/fragment@29:target:0";
		i2c0 = "/fragment@19:target:0", "/fragment@46:target:0";
		i2c1 = "/fragment@20:target:0";
		i2c2 = "/fragment@2:target:0", "/fragment@21:target:0";
		i2c3 = "/fragment@4:target:0", "/fragment@22:target:0";
		i2c4 = "/fragment@23:target:0";
		i2c5 = "/fragment@24:target:0";
		i2c6 = "/fragment@25:target:0";
		i2c7 = "/fragment@26:target:0";
		i2c8 = "/fragment@27:target:0", "/fragment@63:target:0";
		i2c9 = "/fragment@28:target:0";
		irtx_pwm = "/fragment@14:target:0";
		kd_camera_hw1 = "/fragment@43:target:0", "/fragment@53:target:0";
		keypad = "/fragment@45:target:0";
		lk_charger = "/fragment@64:target:0";
		main_pmic = "/fragment@39:target:0";
		md1_sim1_hot_plug_eint = "/fragment@40:target:0";
		md_auxadc = "/fragment@17:target:0";
		mrdump_ext_rst = "/fragment@31:target:0";
		msdc1_ins = "/fragment@34:target:0";
		mt6360_pmu = "/fragment@9:target:0";
		mt6360_typec = "/fragment@10:target:0";
		mt_pmic_vcamio_ldo_reg = "/fragment@41:target:0", "/fragment@43/__overlay__:vcamio-supply:0", "/fragment@43/__overlay__:vcamio_sub-supply:0", "/fragment@43/__overlay__:vcamio_main2-supply:0", "/fragment@43/__overlay__:vcamaf-supply:0", "/fragment@43/__overlay__:vcamaf_main2-supply:0", "/fragment@51:target:0", "/fragment@53/__overlay__:cam0_vcamio-supply:0", "/fragment@53/__overlay__:cam1_vcamio-supply:0", "/fragment@53/__overlay__:cam2_vcamio-supply:0", "/fragment@53/__overlay__:cam3_vcamio-supply:0", "/fragment@53/__overlay__:cam4_vcamio-supply:0";
		mt_pmic_vtp_ldo_reg = "/fragment@42:target:0", "/fragment@43/__overlay__:vcamaf_sub2-supply:0", "/fragment@46/__overlay__/gt9886@5d:vtouch-supply:0", "/fragment@47/__overlay__:vtouch-supply:0";
		mtkfb = "/fragment@8:target:0";
		odm = "/fragment@6:target:0", "/fragment@58:target:0";
		pio = "/fragment@3:target:0", "/fragment@4/__overlay__/nxp@28:qcom,nq-irq:0", "/fragment@4/__overlay__/nxp@28:interrupt-parent:0", "/fragment@4/__overlay__/nxp@28:qcom,nq-ven:0", "/fragment@4/__overlay__/nxp@28:qcom,nq-firm:0", "/fragment@4/__overlay__/nxp@28:qcom,nq-clkreq:0", "/fragment@7:target:0", "/fragment@9/__overlay__:mt6360,intr_gpio:0", "/fragment@10/__overlay__:mt6360pd,intr_gpio:0", "/fragment@10/__overlay__:mt6360pd,pcb_gpio:0", "/fragment@11:target:0", "/fragment@12:target:0", "/fragment@15:target:0", "/fragment@29/__overlay__:GPIO_SIM1_SIO:0", "/fragment@29/__overlay__:GPIO_SIM1_SRST:0", "/fragment@29/__overlay__:GPIO_SIM1_SCLK:0", "/fragment@29/__overlay__:GPIO_SIM2_SCLK:0", "/fragment@29/__overlay__:GPIO_SIM2_SRST:0", "/fragment@29/__overlay__:GPIO_SIM2_SIO:0", "/fragment@29/__overlay__:GPIO_SIM1_HOT_PLUG:0", "/fragment@29/__overlay__:GPIO_SIM2_HOT_PLUG:0", "/fragment@31/__overlay__:interrupt-parent:0", "/fragment@31/__overlay__:deb-gpios:0", "/fragment@32/__overlay__:interrupt-parent:0", "/fragment@33/__overlay__:interrupt-parent:0", "/fragment@34/__overlay__:interrupt-parent:0", "/fragment@35/__overlay__:interrupt-parent:0", "/fragment@36/__overlay__:interrupt-parent:0", "/fragment@37/__overlay__:interrupt-parent:0", "/fragment@38/__overlay__:interrupt-parent:0", "/fragment@39/__overlay__:interrupt-parent:0", "/fragment@46/__overlay__/gt9886@5d:interrupt-parent:0", "/fragment@46/__overlay__/gt9886@5d:goodix,reset-gpio:0", "/fragment@46/__overlay__/gt9886@5d:goodix,irq-gpio:0", "/fragment@47/__overlay__:interrupt-parent:0", "/fragment@47/__overlay__:goodix,eint-gpio:0", "/fragment@47/__overlay__:goodix,reset-gpio:0", "/fragment@48:target:0", "/fragment@49:target:0", "/fragment@50/__overlay__:novatek,reset-gpio:0", "/fragment@50/__overlay__:novatek,irq-gpio:0", "/fragment@50/__overlay__:novatek,reset-tddi:0", "/fragment@52:target:0", "/fragment@55/__overlay__:fpc,gpio_irq:0", "/fragment@55/__overlay__:interrupt-parent:0", "/fragment@56:target:0", "/fragment@58/__overlay__/simtray:status-gpio:0", "/fragment@58/__overlay__/simtray:status-gpio:12", "/fragment@59/__overlay__:focaltech,reset-gpio:0", "/fragment@59/__overlay__:focaltech,irq-gpio:0", "/fragment@63/__overlay__/smb1351-charger@1d:interrupt-parent:0", "/fragment@63/__overlay__/smb1351-charger@1d:qcom,smb1351_susp:0", "/fragment@63/__overlay__/smb1351-charger@1d:mi,connect_therm:0";
		pmic_clock_buffer_ctrl = "/fragment@18:target:0";
		reserved_memory = "/fragment@0:target:0";
		smart_pa = "/fragment@38:target:0";
		spi0 = "/fragment@54:target:0";
		spi1 = "/fragment@60:target:0";
		spi5 = "/fragment@57:target:0";
		subpmic_pmu_eint = "/fragment@37:target:0";
		tcpc_pd = "/fragment@33:target:0";
		thermal_message = "/fragment@62:target:0";
		touch = "/fragment@32:target:0", "/fragment@44:target:0", "/fragment@47:target:0";
		ts_focal = "/fragment@59:target:0";
		ts_novatek = "/fragment@50:target:0";
		usb0phy = "/fragment@66:target:0";
		xiaomi_touch = "/fragment@61:target:0";
	};

	__local_fixups__ {

		fragment@13 {

			__overlay__ {
				pinctrl-0 = <0x0>;
				pinctrl-1 = <0x0>;
				pinctrl-2 = <0x0>;
				pinctrl-3 = <0x0>;
			};
		};

		fragment@14 {

			__overlay__ {
				pinctrl-0 = <0x0>;
				pinctrl-1 = <0x0>;
			};
		};

		fragment@4 {

			__overlay__ {

				nxp@28 {
					pinctrl-0 = <0x0>;
					pinctrl-1 = <0x0 0x4 0x8 0xc>;
					pinctrl-2 = <0x0 0x4 0x8 0xc>;
				};
			};
		};

		fragment@46 {

			__overlay__ {
				pinctrl-0 = <0x0>;
				pinctrl-1 = <0x0>;
				pinctrl-2 = <0x0>;
				pinctrl-3 = <0x0>;
				pinctrl-4 = <0x0>;
				pinctrl-5 = <0x0>;
				pinctrl-6 = <0x0>;
			};
		};

		fragment@50 {

			__overlay__ {
				pinctrl-0 = <0x0 0x4>;
				pinctrl-1 = <0x0 0x4>;
			};
		};

		fragment@53 {

			__overlay__ {
				pinctrl-0 = <0x0>;
				pinctrl-1 = <0x0>;
				pinctrl-10 = <0x0>;
				pinctrl-11 = <0x0>;
				pinctrl-12 = <0x0>;
				pinctrl-13 = <0x0>;
				pinctrl-14 = <0x0>;
				pinctrl-15 = <0x0>;
				pinctrl-16 = <0x0>;
				pinctrl-17 = <0x0>;
				pinctrl-18 = <0x0>;
				pinctrl-19 = <0x0>;
				pinctrl-2 = <0x0>;
				pinctrl-20 = <0x0>;
				pinctrl-21 = <0x0>;
				pinctrl-22 = <0x0>;
				pinctrl-23 = <0x0>;
				pinctrl-24 = <0x0>;
				pinctrl-25 = <0x0>;
				pinctrl-26 = <0x0>;
				pinctrl-27 = <0x0>;
				pinctrl-28 = <0x0>;
				pinctrl-29 = <0x0>;
				pinctrl-3 = <0x0>;
				pinctrl-30 = <0x0>;
				pinctrl-31 = <0x0>;
				pinctrl-32 = <0x0>;
				pinctrl-33 = <0x0>;
				pinctrl-34 = <0x0>;
				pinctrl-35 = <0x0>;
				pinctrl-36 = <0x0>;
				pinctrl-37 = <0x0>;
				pinctrl-38 = <0x0>;
				pinctrl-39 = <0x0>;
				pinctrl-4 = <0x0>;
				pinctrl-40 = <0x0>;
				pinctrl-41 = <0x0>;
				pinctrl-42 = <0x0>;
				pinctrl-43 = <0x0>;
				pinctrl-44 = <0x0>;
				pinctrl-45 = <0x0>;
				pinctrl-46 = <0x0>;
				pinctrl-47 = <0x0>;
				pinctrl-48 = <0x0>;
				pinctrl-49 = <0x0>;
				pinctrl-5 = <0x0>;
				pinctrl-50 = <0x0>;
				pinctrl-51 = <0x0>;
				pinctrl-52 = <0x0>;
				pinctrl-53 = <0x0>;
				pinctrl-54 = <0x0>;
				pinctrl-55 = <0x0>;
				pinctrl-56 = <0x0>;
				pinctrl-57 = <0x0>;
				pinctrl-58 = <0x0>;
				pinctrl-59 = <0x0>;
				pinctrl-6 = <0x0>;
				pinctrl-60 = <0x0>;
				pinctrl-61 = <0x0>;
				pinctrl-62 = <0x0>;
				pinctrl-63 = <0x0>;
				pinctrl-64 = <0x0>;
				pinctrl-65 = <0x0>;
				pinctrl-66 = <0x0>;
				pinctrl-67 = <0x0>;
				pinctrl-7 = <0x0>;
				pinctrl-8 = <0x0>;
				pinctrl-9 = <0x0>;
			};
		};

		fragment@55 {

			__overlay__ {
				pinctrl-0 = <0x0>;
				pinctrl-1 = <0x0>;
				pinctrl-2 = <0x0>;
			};
		};

		fragment@6 {

			__overlay__ {

				usb_c_pinctrl {
					pinctrl-0 = <0x0>;
					pinctrl-1 = <0x0>;
					pinctrl-10 = <0x0>;
					pinctrl-11 = <0x0>;
					pinctrl-12 = <0x0>;
					pinctrl-2 = <0x0>;
					pinctrl-3 = <0x0>;
					pinctrl-4 = <0x0>;
					pinctrl-5 = <0x0>;
					pinctrl-6 = <0x0>;
					pinctrl-7 = <0x0>;
					pinctrl-8 = <0x0>;
					pinctrl-9 = <0x0>;
				};
			};
		};

		fragment@8 {

			__overlay__ {
				pinctrl-0 = <0x0>;
				pinctrl-1 = <0x0>;
				pinctrl-2 = <0x0>;
				pinctrl-3 = <0x0>;
				pinctrl-4 = <0x0>;
				pinctrl-5 = <0x0>;
				pinctrl-6 = <0x0>;
				pinctrl-7 = <0x0>;
				pinctrl-8 = <0x0>;
			};
		};
	};

	__symbols__ {
		camera0_mclk_2ma = "/fragment@52/__overlay__/camera0_mclk_2ma@gpio116";
		camera0_mclk_4ma = "/fragment@52/__overlay__/camera0_mclk_4ma@gpio116";
		camera0_mclk_6ma = "/fragment@52/__overlay__/camera0_mclk_6ma@gpio116";
		camera0_mclk_8ma = "/fragment@52/__overlay__/camera0_mclk_8ma@gpio116";
		camera0_mclk_off = "/fragment@52/__overlay__/camera0_mclk_gpio_mode@gpio116";
		camera0_pdn_high = "/fragment@52/__overlay__/camera0_pdn_output_high@gpio93";
		camera0_pdn_low = "/fragment@52/__overlay__/camera0_pdn_output_low@gpio93";
		camera0_rst_high = "/fragment@52/__overlay__/camera0_rst_output_high@gpio118";
		camera0_rst_low = "/fragment@52/__overlay__/camera0_rst_output_low@gpio118";
		camera0_vcama_off = "/fragment@52/__overlay__/camera0_vcama_output_low@gpio114";
		camera0_vcama_on = "/fragment@52/__overlay__/camera0_vcama_output_high@gpio114";
		camera0_vcamd_off = "/fragment@52/__overlay__/camera0_vcamd_output_low@gpio114";
		camera0_vcamd_on = "/fragment@52/__overlay__/camera0_vcamd_output_high@gpio114";
		camera1_mclk_2ma = "/fragment@52/__overlay__/camera1_mclk_2ma@gpio120";
		camera1_mclk_4ma = "/fragment@52/__overlay__/camera1_mclk_4ma@gpio120";
		camera1_mclk_6ma = "/fragment@52/__overlay__/camera1_mclk_6ma@gpio120";
		camera1_mclk_8ma = "/fragment@52/__overlay__/camera1_mclk_8ma@gpio120";
		camera1_mclk_off = "/fragment@52/__overlay__/camera1_mclk_gpio_mode@gpio120";
		camera1_pdn_high = "/fragment@52/__overlay__/camera1_pdn_output_high@gpio122";
		camera1_pdn_low = "/fragment@52/__overlay__/camera1_pdn_output_low@gpio122";
		camera1_rst_high = "/fragment@52/__overlay__/camera1_rst_output_high@gpio124";
		camera1_rst_low = "/fragment@52/__overlay__/camera1_rst_output_low@gpio124";
		camera1_vcama_off = "/fragment@52/__overlay__/camera1_vcama_output_low@gpio123";
		camera1_vcama_on = "/fragment@52/__overlay__/camera1_vcama_output_hgigh@gpio123";
		camera1_vcamd_off = "/fragment@52/__overlay__/camera1_vcamd_output_low@gpio122";
		camera1_vcamd_on = "/fragment@52/__overlay__/camera1_vcamd_output_high@gpio122";
		camera2_mclk_2ma = "/fragment@52/__overlay__/camera2_mclk_2ma@gpio121";
		camera2_mclk_4ma = "/fragment@52/__overlay__/camera2_mclk_4ma@gpio121";
		camera2_mclk_6ma = "/fragment@52/__overlay__/camera2_mclk_6ma@gpio121";
		camera2_mclk_8ma = "/fragment@52/__overlay__/camera2_mclk_8ma@gpio121";
		camera2_mclk_off = "/fragment@52/__overlay__/camera2_mclk_gpio_mode@gpio121";
		camera2_pdn_high = "/fragment@52/__overlay__/camera2_pdn_output_high@gpio123";
		camera2_pdn_low = "/fragment@52/__overlay__/camera2_pdn_output_low@gpio123";
		camera2_rst_high = "/fragment@52/__overlay__/camera2_rst_output_high@gpio125";
		camera2_rst_low = "/fragment@52/__overlay__/camera2_rst_output_low@gpio125";
		camera2_vcama_off = "/fragment@52/__overlay__/camera2_vcama_output_low@gpio123";
		camera2_vcama_on = "/fragment@52/__overlay__/camera2_vcama_output_high@gpio123";
		camera2_vcamd_off = "/fragment@52/__overlay__/camera2_vcamd_output_low@gpio123";
		camera2_vcamd_on = "/fragment@52/__overlay__/camera2_vcamd_output_high@gpio123";
		camera3_mclk_2ma = "/fragment@52/__overlay__/camera3_mclk_2ma@gpio117";
		camera3_mclk_4ma = "/fragment@52/__overlay__/camera3_mclk_4ma@gpio117";
		camera3_mclk_6ma = "/fragment@52/__overlay__/camera3_mclk_6ma@gpio117";
		camera3_mclk_8ma = "/fragment@52/__overlay__/camera3_mclk_8ma@gpio117";
		camera3_mclk_off = "/fragment@52/__overlay__/camera3_mclk_gpio_mode@gpio117";
		camera3_pdn_high = "/fragment@52/__overlay__/camera3_pdn_output_high@gpio115";
		camera3_pdn_low = "/fragment@52/__overlay__/camera3_pdn_output_low@gpio115";
		camera3_rst_high = "/fragment@52/__overlay__/camera3_rst_output_high@gpio119";
		camera3_rst_low = "/fragment@52/__overlay__/camera3_rst_output_low@gpio119";
		camera3_vcama_off = "/fragment@52/__overlay__/camera3_vcama_output_low@gpio195";
		camera3_vcama_on = "/fragment@52/__overlay__/camera3_vcama_output_high@gpio195";
		camera3_vcamd_off = "/fragment@52/__overlay__/camera3_vcamd_output_low@gpio195";
		camera3_vcamd_on = "/fragment@52/__overlay__/camera3_vcamd_output_high@gpio195";
		camera4_mclk_2ma = "/fragment@52/__overlay__/camera4_mclk_2ma@gpio196";
		camera4_mclk_4ma = "/fragment@52/__overlay__/camera4_mclk_4ma@gpio196";
		camera4_mclk_6ma = "/fragment@52/__overlay__/camera4_mclk_6ma@gpio196";
		camera4_mclk_8ma = "/fragment@52/__overlay__/camera4_mclk_8ma@gpio196";
		camera4_mclk_off = "/fragment@52/__overlay__/camera4_mclk_gpio_mode@gpio196";
		camera4_pdn_high = "/fragment@52/__overlay__/camera4_pdn_output_high@gpio115";
		camera4_pdn_low = "/fragment@52/__overlay__/camera4_pdn_output_low@gpio115";
		camera4_rst_high = "/fragment@52/__overlay__/camera4_rst_output_high@gpio197";
		camera4_rst_low = "/fragment@52/__overlay__/camera4_rst_output_low@gpio197";
		camera4_vcama_off = "/fragment@52/__overlay__/camera4_vcama_output_low@gpio195";
		camera4_vcama_on = "/fragment@52/__overlay__/camera4_vcama_output_high@gpio195";
		camera4_vcamd_off = "/fragment@52/__overlay__/camera4_vcamd_output_low@gpio195";
		camera4_vcamd_on = "/fragment@52/__overlay__/camera4_vcamd_output_high@gpio195";
		camera_main_af_mtk = "/fragment@21/__overlay__/camera_main_af@0c";
		camera_main_eeprom_mtk = "/fragment@21/__overlay__/camera_main_eeprom@50";
		camera_main_mtk = "/fragment@21/__overlay__/camera_main@1a";
		camera_main_two_af_mtk = "/fragment@26/__overlay__/camera_main_two_af@0c";
		camera_main_two_eeprom_mtk = "/fragment@26/__overlay__/camera_main_two_eeprom@50";
		camera_main_two_mtk = "/fragment@26/__overlay__/camera_main_two@10";
		camera_pins_cam_mipi_sel_0 = "/fragment@52/__overlay__/mipi_sel@0";
		camera_pins_cam_mipi_sel_1 = "/fragment@52/__overlay__/mipi_sel@1";
		camera_pins_default = "/fragment@52/__overlay__/camdefault";
		camera_sub_eeprom_mtk = "/fragment@23/__overlay__/camera_sub_eeprom@52";
		camera_sub_mtk = "/fragment@23/__overlay__/camera_sub@2d";
		camera_sub_two_af_mtk = "/fragment@23/__overlay__/camera_sub_two_af@18";
		camera_sub_two_eeprom_mtk = "/fragment@23/__overlay__/camera_sub_two_eeprom@63";
		camera_sub_two_mtk = "/fragment@23/__overlay__/camera_sub_two@2e";
		cap_touch_mtk = "/fragment@19/__overlay__/cap_touch@14";
		ccu_sensor_i2c_main2_hw_mtk = "/fragment@26/__overlay__/ccu_sensor_i2c_main2_hw@36";
		ccu_sensor_i2c_main3_hw_mtk = "/fragment@26/__overlay__/ccu_sensor_i2c_main3_hw@11";
		ccu_sensor_i2c_main_hw_mtk = "/fragment@21/__overlay__/ccu_sensor_i2c_main_hw@33";
		ccu_sensor_i2c_sub2_hw_mtk = "/fragment@23/__overlay__/ccu_sensor_i2c_sub2_hw@12";
		ccu_sensor_i2c_sub_hw_mtk = "/fragment@23/__overlay__/ccu_sensor_i2c_sub_hw@43";
		consys_pins_default = "/fragment@12/__overlay__/consys_default";
		ctp_pins_default = "/fragment@48/__overlay__/eintdefault";
		ctp_ts_i2c_mode = "/fragment@48/__overlay__/i2cmode_default";
		ctp_ts_int_active = "/fragment@48/__overlay__/int_active";
		ctp_ts_int_as_gpio = "/fragment@48/__overlay__/int_high";
		ctp_ts_int_suspend = "/fragment@48/__overlay__/int_suspend";
		ctp_ts_reset_active = "/fragment@48/__overlay__/reset_active";
		ctp_ts_reset_suspend = "/fragment@48/__overlay__/reset_suspend";
		fingerprint_default = "/fragment@56/__overlay__/state_default";
		fingerprint_reset_high = "/fragment@56/__overlay__/state_reset_high";
		fingerprint_reset_low = "/fragment@56/__overlay__/state_reset_low";
		gpio_redriver_c1_high = "/fragment@11/__overlay__/c1_high";
		gpio_redriver_c1_hiz = "/fragment@11/__overlay__/c1_highz";
		gpio_redriver_c1_init = "/fragment@11/__overlay__/c1_init";
		gpio_redriver_c1_low = "/fragment@11/__overlay__/c1_low";
		gpio_redriver_c2_high = "/fragment@11/__overlay__/c2_high";
		gpio_redriver_c2_hiz = "/fragment@11/__overlay__/c2_highz";
		gpio_redriver_c2_init = "/fragment@11/__overlay__/c2_init";
		gpio_redriver_c2_low = "/fragment@11/__overlay__/c2_low";
		gpio_u3_switch_disable = "/fragment@11/__overlay__/u3_sw_dis";
		gpio_u3_switch_enable = "/fragment@11/__overlay__/u3_sw_en";
		gpio_u3_switch_sel1 = "/fragment@11/__overlay__/u3_sw_sel1";
		gpio_u3_switch_sel2 = "/fragment@11/__overlay__/u3_sw_sel2";
		gpslna_pins_init = "/fragment@12/__overlay__/gpslna@0";
		gpslna_pins_oh = "/fragment@12/__overlay__/gpslna@1";
		gpslna_pins_ol = "/fragment@12/__overlay__/gpslna@2";
		i2c_lcd_bias_mtk = "/fragment@19/__overlay__/i2c_lcd_bias@11";
		irtx_gpio_led_default = "/fragment@15/__overlay__/irtx_gpio_led_def@gpio26";
		irtx_gpio_led_set = "/fragment@15/__overlay__/irtx_gpio_led_set@gpio26";
		led0 = "/fragment@6/__overlay__/led@0";
		led1 = "/fragment@6/__overlay__/led@1";
		led2 = "/fragment@6/__overlay__/led@2";
		led3 = "/fragment@6/__overlay__/led@3";
		led4 = "/fragment@6/__overlay__/led@4";
		led5 = "/fragment@6/__overlay__/led@5";
		led6 = "/fragment@6/__overlay__/led@6";
		mtkfb_pins_lcd_bias_enn0 = "/fragment@7/__overlay__/lcd_bias_enn0_gpio";
		mtkfb_pins_lcd_bias_enn1 = "/fragment@7/__overlay__/lcd_bias_enn1_gpio";
		mtkfb_pins_lcd_bias_enp0 = "/fragment@7/__overlay__/lcd_bias_enp0_gpio";
		mtkfb_pins_lcd_bias_enp1 = "/fragment@7/__overlay__/lcd_bias_enp1_gpio";
		mtkfb_pins_lcd_bl_bias_en0 = "/fragment@7/__overlay__/lcd_bl_bias_en0_gpio";
		mtkfb_pins_lcd_bl_bias_en1 = "/fragment@7/__overlay__/lcd_bl_bias_en1_gpio";
		mtkfb_pins_lcm_dsi_te = "/fragment@7/__overlay__/lcm_dsi_te";
		mtkfb_pins_lcm_rst_out0_gpio = "/fragment@7/__overlay__/lcm_rst_out0_gpio";
		mtkfb_pins_lcm_rst_out1_gpio = "/fragment@7/__overlay__/lcm_rst_out1_gpio";
		nfc_clk_req_active = "/fragment@3/__overlay__/nfc_clk_req_active";
		nfc_clk_req_suspend = "/fragment@3/__overlay__/nfc_clk_req_suspend";
		nfc_default = "/fragment@3/__overlay__/nfc_default";
		nfc_enable_active = "/fragment@3/__overlay__/nfc_enable_active";
		nfc_enable_suspend = "/fragment@3/__overlay__/nfc_enable_suspend";
		nfc_firmwaredownload_active = "/fragment@3/__overlay__/nfc_firmwaredownload_active";
		nfc_firmwaredownload_suspend = "/fragment@3/__overlay__/nfc_firmwaredownload_suspend";
		nfc_int_active = "/fragment@3/__overlay__/nfc_int_active";
		nfc_int_suspend = "/fragment@3/__overlay__/nfc_int_suspend";
		nfc_mtk = "/fragment@22/__overlay__/nfc@08";
		subpmic_ldo_mtk = "/fragment@24/__overlay__/subpmic_ldo@64";
		subpmic_mtk = "/fragment@24/__overlay__/subpmic@34";
		subpmic_pmic_mtk = "/fragment@24/__overlay__/subpmic_pmic@1a";
		ts_int_active = "/fragment@49/__overlay__/ts_int_active";
		ts_int_suspend = "/fragment@49/__overlay__/ts_int_suspend";
		ts_reset_active = "/fragment@49/__overlay__/ts_reset_active";
		ts_reset_suspend = "/fragment@49/__overlay__/ts_reset_suspend";
		usb_c_pinctrl = "/fragment@6/__overlay__/usb_c_pinctrl";
		usb_default = "/fragment@11/__overlay__/usb_default";
		usb_type_c_mtk = "/fragment@24/__overlay__/usb_type_c@4e";
		vibrator0 = "/fragment@6/__overlay__/vibrator@0";
		vproc_buck_mtk = "/fragment@28/__overlay__/vproc_buck@6b";
	};

	fragment@0 {
		target = <0xffffffff>;

		__overlay__ {
		};
	};

	fragment@1 {
		target = <0xffffffff>;

		__overlay__ {
			atag,videolfb-fb_base_h = <0x0>;
			atag,videolfb-fb_base_l = "~`P";
			atag,videolfb-fps = <0x1770>;
			atag,videolfb-islcm_inited = <0x0>;
			atag,videolfb-islcmfound = <0x1>;
			atag,videolfb-lcmname = "nt35695_fhd_dsi_cmd_truly_rt5081_drv";
			atag,videolfb-vramSize = <0x17e8000>;
		};
	};

	fragment@10 {
		target = <0xffffffff>;

		__overlay__ {
			mt6360pd,intr_gpio = <0xffffffff 0x7 0x0>;
			mt6360pd,intr_gpio_num = <0x7>;
			mt6360pd,pcb_gpio = <0xffffffff 0x5 0x0>;
			mt6360pd,pcb_gpio_num = <0x5>;
			mt6360pd,pcb_gpio_polarity = <0x1>;
		};
	};

	fragment@11 {
		target = <0xffffffff>;

		__overlay__ {

			c1_high {
				phandle = <0xe>;

				pins_cmd_dat {
					output-high;
					pinmux = <0x1f00>;
					slew-rate = <0x1>;
				};
			};

			c1_highz {
				phandle = <0xd>;

				pins_cmd_dat {
					bias-disable;
					pinmux = <0x1f00>;
					slew-rate = <0x0>;
				};
			};

			c1_init {
				phandle = <0xb>;

				pins_cmd_dat {
					output-low;
					pinmux = <0x1f00>;
					slew-rate = <0x1>;
				};
			};

			c1_low {
				phandle = <0xc>;

				pins_cmd_dat {
					output-low;
					pinmux = <0x1f00>;
					slew-rate = <0x1>;
				};
			};

			c2_high {
				phandle = <0x12>;

				pins_cmd_dat {
					output-high;
					pinmux = <0x1e00>;
					slew-rate = <0x1>;
				};
			};

			c2_highz {
				phandle = <0x11>;

				pins_cmd_dat {
					bias-disable;
					pinmux = <0x1e00>;
					slew-rate = <0x0>;
				};
			};

			c2_init {
				phandle = <0xf>;

				pins_cmd_dat {
					output-low;
					pinmux = <0x1e00>;
					slew-rate = <0x1>;
				};
			};

			c2_low {
				phandle = <0x10>;

				pins_cmd_dat {
					output-low;
					pinmux = <0x1e00>;
					slew-rate = <0x1>;
				};
			};

			u3_sw_dis {
				phandle = <0x16>;
			};

			u3_sw_en {
				phandle = <0x15>;
			};

			u3_sw_sel1 {
				phandle = <0x13>;

				pins_cmd_dat {
					output-low;
					pinmux = <0x2000>;
					slew-rate = <0x1>;
				};
			};

			u3_sw_sel2 {
				phandle = <0x14>;

				pins_cmd_dat {
					output-high;
					pinmux = <0x2000>;
					slew-rate = <0x1>;
				};
			};

			usb_default {
				phandle = <0xa>;
			};
		};
	};

	fragment@12 {
		target = <0xffffffff>;

		__overlay__ {

			consys_default {
				phandle = <0x20>;
			};

			gpslna@0 {
				phandle = <0x21>;

				pins_cmd_dat {
					bias-disable;
					output-low;
					pinmux = <0x4a00>;
					slew-rate = <0x0>;
				};
			};

			gpslna@1 {
				phandle = <0x22>;

				pins_cmd_dat {
					output-high;
					pinmux = <0x4a00>;
					slew-rate = <0x1>;
				};
			};

			gpslna@2 {
				phandle = <0x23>;

				pins_cmd_dat {
					output-low;
					pinmux = <0x4a00>;
					slew-rate = <0x1>;
				};
			};
		};
	};

	fragment@13 {
		target = <0xffffffff>;

		__overlay__ {
			pinctrl-0 = <0x20>;
			pinctrl-1 = <0x21>;
			pinctrl-2 = <0x22>;
			pinctrl-3 = <0x23>;
			pinctrl-names = "default", "gps_lna_state_init", "gps_lna_state_oh", "gps_lna_state_ol";
			status = "okay";
		};
	};

	fragment@14 {
		target = <0xffffffff>;

		__overlay__ {
			pinctrl-0 = <0x24>;
			pinctrl-1 = <0x25>;
			pinctrl-names = "irtx_gpio_led_default", "irtx_gpio_led_set";
			status = "okay";
		};
	};

	fragment@15 {
		target = <0xffffffff>;

		__overlay__ {

			irtx_gpio_led_def@gpio26 {
				phandle = <0x24>;

				pins_cmd_dat {
					bias-disable;
					input-schmitt-enable = <0x0>;
					output-low;
					pinmux = <0x1a00>;
					slew-rate = <0x1>;
				};
			};

			irtx_gpio_led_set@gpio26 {
				phandle = <0x25>;

				pins_cmd_dat {
					output-high;
					pinmux = <0x1a01>;
					slew-rate = <0x1>;
				};
			};
		};
	};

	fragment@16 {
		target = <0xffffffff>;

		__overlay__ {

			adc_channel@ {
				compatible = "mediatek,adc_channel";
				mediatek,adc_fdd_rf_params_dynamic_custom_ch = <0x4>;
				mediatek,temperature0 = <0x0>;
				mediatek,temperature1 = <0x1>;
				status = "okay";
			};
		};
	};

	fragment@17 {
		target = <0xffffffff>;

		__overlay__ {
			io-channels = <0xffffffff 0x4>;
		};
	};

	fragment@18 {
		target = <0xffffffff>;

		__overlay__ {
			mediatek,clkbuf-config = <0x2 0x1 0x1 0x2 0x0 0x0 0x1>;
			mediatek,clkbuf-controls-for-desense = <0x0 0x4 0x0 0x3 0x0 0x0 0x0>;
			mediatek,clkbuf-output-impedance = <0x4 0x4 0x4 0x4 0x0 0x0 0x4>;
			mediatek,clkbuf-quantity = <0x7>;
			status = "okay";
		};
	};

	fragment@19 {
		target = <0xffffffff>;

		__overlay__ {
			#address-cells = <0x1>;
			#size-cells = <0x0>;
			clock-frequency = <0x61a80>;
			mediatek,use-open-drain;

			cap_touch@14 {
				compatible = "mediatek,cap_touch";
				phandle = <0x81>;
				reg = <0x14>;
				status = "okay";
			};

			i2c_lcd_bias@11 {
				compatible = "mediatek,i2c_lcd_bias";
				phandle = <0x82>;
				reg = <0x11>;
				status = "okay";
			};
		};
	};

	fragment@2 {
		target = <0xffffffff>;

		__overlay__ {
			clock-frequency = <0x61a80>;

			mtk-usb@60 {
				compatible = "mediatek,mtk-usb";
				reg = <0x60>;
				status = "okay";
			};
		};
	};

	fragment@20 {
		target = <0xffffffff>;

		__overlay__ {
			#address-cells = <0x1>;
			#size-cells = <0x0>;
			clock-frequency = <0x61a80>;
			mediatek,use-open-drain;
		};
	};

	fragment@21 {
		target = <0xffffffff>;

		__overlay__ {
			#address-cells = <0x1>;
			#size-cells = <0x0>;
			clock-frequency = <0x61a80>;
			mediatek,use-open-drain;

			camera_main@1a {
				compatible = "mediatek,camera_main";
				phandle = <0x83>;
				reg = <0x1a>;
				status = "okay";
			};

			camera_main_af@0c {
				compatible = "mediatek,camera_main_af";
				phandle = <0x84>;
				reg = <0xc>;
				status = "okay";
			};

			camera_main_eeprom@50 {
				compatible = "mediatek,camera_main_eeprom";
				phandle = <0x85>;
				reg = <0x50>;
				status = "okay";
			};

			ccu_sensor_i2c_main_hw@33 {
				compatible = "mediatek,ccu_sensor_i2c_main_hw";
				phandle = <0x86>;
				reg = <0x33>;
				status = "okay";
			};
		};
	};

	fragment@22 {
		target = <0xffffffff>;

		__overlay__ {
			#address-cells = <0x1>;
			#size-cells = <0x0>;
			clock-frequency = <0x61a80>;
			mediatek,use-open-drain;

			nfc@08 {
				compatible = "mediatek,nfc";
				phandle = <0x87>;
				reg = <0x8>;
				status = "okay";
			};
		};
	};

	fragment@23 {
		target = <0xffffffff>;

		__overlay__ {
			#address-cells = <0x1>;
			#size-cells = <0x0>;
			clock-frequency = <0x61a80>;
			mediatek,use-open-drain;

			camera_sub@2d {
				compatible = "mediatek,camera_sub";
				phandle = <0x88>;
				reg = <0x2d>;
				status = "okay";
			};

			camera_sub_eeprom@52 {
				compatible = "mediatek,camera_sub_eeprom";
				phandle = <0x89>;
				reg = <0x52>;
				status = "okay";
			};

			camera_sub_two@2e {
				compatible = "mediatek,camera_sub_two";
				phandle = <0x8b>;
				reg = <0x2e>;
				status = "okay";
			};

			camera_sub_two_af@18 {
				compatible = "mediatek,camera_sub_two_af";
				phandle = <0x8c>;
				reg = <0x18>;
				status = "okay";
			};

			camera_sub_two_eeprom@63 {
				compatible = "mediatek,camera_sub_two_eeprom";
				phandle = <0x8d>;
				reg = <0x63>;
				status = "okay";
			};

			ccu_sensor_i2c_sub2_hw@12 {
				compatible = "mediatek,ccu_sensor_i2c_sub2_hw";
				phandle = <0x8e>;
				reg = <0x12>;
				status = "okay";
			};

			ccu_sensor_i2c_sub_hw@43 {
				compatible = "mediatek,ccu_sensor_i2c_sub_hw";
				phandle = <0x8a>;
				reg = <0x43>;
				status = "okay";
			};
		};
	};

	fragment@24 {
		target = <0xffffffff>;

		__overlay__ {
			#address-cells = <0x1>;
			#size-cells = <0x0>;
			clock-frequency = <0x33e140>;
			mediatek,use-push-pull;

			subpmic@34 {
				compatible = "mediatek,subpmic";
				phandle = <0x8f>;
				reg = <0x34>;
				status = "okay";
			};

			subpmic_ldo@64 {
				compatible = "mediatek,subpmic_ldo";
				phandle = <0x92>;
				reg = <0x64>;
				status = "okay";
			};

			subpmic_pmic@1a {
				compatible = "mediatek,subpmic_pmic";
				phandle = <0x91>;
				reg = <0x1a>;
				status = "okay";
			};

			usb_type_c@4e {
				compatible = "mediatek,usb_type_c";
				phandle = <0x90>;
				reg = <0x4e>;
				status = "okay";
			};
		};
	};

	fragment@25 {
		target = <0xffffffff>;

		__overlay__ {
			#address-cells = <0x1>;
			#size-cells = <0x0>;
			clock-frequency = <0x61a80>;
			mediatek,use-open-drain;
		};
	};

	fragment@26 {
		target = <0xffffffff>;

		__overlay__ {
			#address-cells = <0x1>;
			#size-cells = <0x0>;
			clock-frequency = <0x61a80>;
			mediatek,use-open-drain;

			camera_main_two@10 {
				compatible = "mediatek,camera_main_two";
				phandle = <0x93>;
				reg = <0x10>;
				status = "okay";
			};

			camera_main_two_af@0c {
				compatible = "mediatek,camera_main_two_af";
				phandle = <0x94>;
				reg = <0xc>;
				status = "okay";
			};

			camera_main_two_eeprom@50 {
				compatible = "mediatek,camera_main_two_eeprom";
				phandle = <0x95>;
				reg = <0x50>;
				status = "okay";
			};

			ccu_sensor_i2c_main2_hw@36 {
				compatible = "mediatek,ccu_sensor_i2c_main2_hw";
				phandle = <0x96>;
				reg = <0x36>;
				status = "okay";
			};

			ccu_sensor_i2c_main3_hw@11 {
				compatible = "mediatek,ccu_sensor_i2c_main3_hw";
				phandle = <0x97>;
				reg = <0x11>;
				status = "okay";
			};
		};
	};

	fragment@27 {
		target = <0xffffffff>;

		__overlay__ {
			#address-cells = <0x1>;
			#size-cells = <0x0>;
			clock-frequency = <0x61a80>;
			mediatek,use-open-drain;
		};
	};

	fragment@28 {
		target = <0xffffffff>;

		__overlay__ {
			#address-cells = <0x1>;
			#size-cells = <0x0>;
			clock-frequency = <0x33e140>;
			mediatek,use-open-drain;

			vproc_buck@6b {
				compatible = "mediatek,vproc_buck";
				phandle = <0x98>;
				reg = <0x6b>;
				status = "okay";
			};
		};
	};

	fragment@29 {
		target = <0xffffffff>;

		__overlay__ {
			GPIO_SIM1_HOT_PLUG = <0xffffffff 0x8c 0x0>;
			GPIO_SIM1_SCLK = <0xffffffff 0x82 0x0>;
			GPIO_SIM1_SIO = <0xffffffff 0x80 0x0>;
			GPIO_SIM1_SRST = <0xffffffff 0x81 0x0>;
			GPIO_SIM2_HOT_PLUG = <0xffffffff 0x8d 0x0>;
			GPIO_SIM2_SCLK = <0xffffffff 0x83 0x0>;
			GPIO_SIM2_SIO = <0xffffffff 0x85 0x0>;
			GPIO_SIM2_SRST = <0xffffffff 0x84 0x0>;
		};
	};

	fragment@3 {
		target = <0xffffffff>;

		__overlay__ {

			nfc_clk_req_active {
				phandle = <0x4>;

				pins_cmd_dat {
					bias-pull-up;
					drive-strength = <0x2>;
					input-enable;
					pinmux = <0x1901>;
					slew-rate = <0x0>;
				};
			};

			nfc_clk_req_suspend {
				phandle = <0x8>;

				pins_cmd_dat {
					bias-pull-down;
					drive-strength = <0x2>;
					input-enable;
					pinmux = <0x1901>;
					slew-rate = <0x0>;
				};
			};

			nfc_default {
				phandle = <0x1>;
			};

			nfc_enable_active {
				phandle = <0x3>;

				pins_cmd_dat {
					bias-pull-up = <0x67>;
					drive-strength = <0x2>;
					output-high;
					pinmux = <0xa800>;
					slew-rate = <0x1>;
				};
			};

			nfc_enable_suspend {
				phandle = <0x7>;

				pins_cmd_dat {
					bias-disable;
					drive-strength = <0x2>;
					pinmux = <0xa800>;
					slew-rate = <0x1>;
				};
			};

			nfc_firmwaredownload_active {
				phandle = <0x5>;

				pins_cmd_dat {
					bias-pull-up;
					drive-strength = <0x2>;
					pinmux = <0x5700>;
					slew-rate = <0x1>;
				};
			};

			nfc_firmwaredownload_suspend {
				phandle = <0x9>;

				pins_cmd_dat {
					bias-disable;
					drive-strength = <0x2>;
					pinmux = <0x5700>;
					slew-rate = <0x1>;
				};
			};

			nfc_int_active {
				phandle = <0x2>;

				pins_cmd_dat {
					bias-pull-up;
					drive-strength = <0x2>;
					pinmux = <0x5800>;
					slew-rate = <0x0>;
				};
			};

			nfc_int_suspend {
				phandle = <0x6>;

				pins_cmd_dat {
					bias-pull-up;
					drive-strength = <0x2>;
					pinmux = <0x5800>;
					slew-rate = <0x0>;
				};
			};
		};
	};

	fragment@30 {
		target = <0xffffffff>;

		__overlay__ {
			gpio_init_default = <0x0 0x0 0x0 0x0 0x1 0x1 0x1 0x1 0x0 0x0 0x0 0x1 0x1 0x1 0x2 0x0 0x1 0x0 0x0 0x0 0x1 0x3 0x0 0x1 0x1 0x0 0x0 0x1 0x4 0x0 0x0 0x0 0x1 0x0 0x1 0x5 0x0 0x0 0x0 0x1 0x1 0x1 0x6 0x0 0x0 0x0 0x1 0x0 0x1 0x7 0x0 0x0 0x0 0x1 0x1 0x1 0x8 0x0 0x0 0x0 0x1 0x1 0x1 0x9 0x0 0x0 0x0 0x1 0x0 0x1 0xa 0x0 0x0 0x0 0x1 0x0 0x1 0xb 0x0 0x0 0x0 0x1 0x1 0x1 0xc 0x0 0x0 0x0 0x1 0x1 0x0 0xd 0x0 0x0 0x0 0x1 0x0 0x0 0xe 0x0 0x1 0x0 0x0 0x0 0x0 0xf 0x0 0x1 0x0 0x0 0x0 0x0 0x10 0x0 0x0 0x0 0x1 0x1 0x1 0x11 0x1 0x0 0x0 0x1 0x0 0x0 0x12 0x1 0x1 0x0 0x0 0x0 0x0 0x13 0x1 0x1 0x0 0x0 0x0 0x0 0x14 0x1 0x1 0x0 0x0 0x0 0x0 0x15 0x0 0x1 0x0 0x0 0x0 0x0 0x16 0x0 0x1 0x1 0x0 0x0 0x0 0x17 0x0 0x1 0x0 0x0 0x0 0x0 0x18 0x0 0x1 0x0 0x0 0x0 0x0 0x19 0x1 0x0 0x0 0x1 0x0 0x0 0x1a 0x0 0x1 0x0 0x0 0x0 0x0 0x1c 0x1 0x0 0x0 0x1 0x1 0x1 0x1d 0x1 0x0 0x0 0x1 0x1 0x1 0x1e 0x0 0x1 0x0 0x0 0x0 0x0 0x1f 0x0 0x1 0x0 0x0 0x0 0x0 0x20 0x0 0x1 0x0 0x0 0x0 0x0 0x21 0x0 0x0 0x0 0x1 0x0 0x0 0x22 0x0 0x1 0x0 0x0 0x0 0x0 0x23 0x5 0x1 0x0 0x0 0x0 0x0 0x24 0x5 0x1 0x0 0x0 0x0 0x0 0x25 0x5 0x0 0x0 0x1 0x0 0x0 0x26 0x5 0x1 0x0 0x0 0x0 0x0 0x27 0x6 0x0 0x0 0x1 0x0 0x0 0x28 0x6 0x0 0x0 0x1 0x0 0x0 0x29 0x6 0x0 0x0 0x1 0x0 0x0 0x2a 0x1 0x1 0x0 0x0 0x0 0x0 0x2b 0x0 0x0 0x0 0x1 0x0 0x0 0x2c 0x0 0x1 0x0 0x0 0x0 0x0 0x2d 0x1 0x0 0x0 0x1 0x1 0x1 0x2e 0x1 0x0 0x0 0x1 0x1 0x1 0x2f 0x1 0x0 0x0 0x1 0x1 0x0 0x30 0x1 0x1 0x1 0x0 0x0 0x0 0x31 0x1 0x1 0x0 0x0 0x0 0x0 0x32 0x1 0x1 0x0 0x0 0x0 0x0 0x33 0x1 0x0 0x0 0x1 0x1 0x1 0x34 0x1 0x0 0x0 0x1 0x1 0x1 0x35 0x1 0x0 0x0 0x1 0x1 0x0 0x36 0x1 0x1 0x1 0x0 0x0 0x0 0x37 0x1 0x0 0x0 0x1 0x1 0x1 0x38 0x1 0x0 0x0 0x1 0x1 0x1 0x39 0x0 0x0 0x0 0x1 0x0 0x0 0x3a 0x0 0x0 0x0 0x1 0x0 0x0 0x3b 0x1 0x0 0x0 0x1 0x1 0x0 0x3c 0x1 0x0 0x0 0x1 0x1 0x0 0x3d 0x2 0x0 0x0 0x1 0x1 0x1 0x3e 0x2 0x0 0x0 0x1 0x1 0x1 0x3f 0x2 0x0 0x0 0x1 0x0 0x0 0x40 0x2 0x1 0x0 0x0 0x0 0x0 0x41 0x2 0x1 0x0 0x0 0x0 0x0 0x42 0x2 0x1 0x0 0x0 0x0 0x0 0x43 0x1 0x1 0x0 0x0 0x0 0x1 0x44 0x1 0x1 0x0 0x0 0x0 0x1 0x45 0x0 0x0 0x0 0x1 0x1 0x1 0x46 0x1 0x0 0x0 0x1 0x0 0x0 0x47 0x1 0x1 0x0 0x0 0x0 0x1 0x48 0x1 0x0 0x0 0x1 0x0 0x0 0x49 0x3 0x0 0x0 0x1 0x0 0x0 0x4a 0x3 0x0 0x0 0x1 0x0 0x0 0x4b 0x1 0x0 0x0 0x1 0x0 0x0 0x4c 0x1 0x0 0x0 0x1 0x0 0x0 0x4d 0x1 0x0 0x0 0x1 0x0 0x0 0x4e 0x1 0x0 0x0 0x1 0x0 0x0 0x4f 0x1 0x0 0x0 0x1 0x0 0x0 0x50 0x1 0x0 0x0 0x1 0x0 0x0 0x51 0x1 0x0 0x0 0x1 0x0 0x0 0x52 0x1 0x0 0x0 0x1 0x0 0x0 0x53 0x1 0x0 0x0 0x1 0x0 0x0 0x54 0x1 0x0 0x0 0x1 0x0 0x0 0x55 0x1 0x0 0x0 0x1 0x0 0x0 0x56 0x1 0x0 0x0 0x1 0x0 0x0 0x57 0x1 0x0 0x0 0x1 0x0 0x0 0x58 0x1 0x0 0x0 0x1 0x0 0x0 0x59 0x1 0x0 0x0 0x1 0x0 0x0 0x5a 0x1 0x0 0x0 0x1 0x0 0x0 0x5b 0x1 0x0 0x0 0x1 0x0 0x0 0x5c 0x1 0x0 0x0 0x1 0x0 0x0 0x5d 0x0 0x1 0x0 0x0 0x0 0x0 0x5e 0x1 0x0 0x0 0x1 0x0 0x0 0x5f 0x1 0x0 0x0 0x1 0x0 0x0 0x60 0x1 0x0 0x0 0x1 0x0 0x0 0x61 0x1 0x0 0x0 0x1 0x0 0x0 0x62 0x1 0x0 0x0 0x1 0x0 0x0 0x63 0x1 0x0 0x0 0x1 0x0 0x0 0x64 0x1 0x0 0x0 0x1 0x0 0x0 0x65 0x1 0x0 0x0 0x1 0x0 0x0 0x66 0x1 0x0 0x0 0x1 0x0 0x0 0x67 0x1 0x0 0x0 0x1 0x0 0x0 0x68 0x1 0x0 0x0 0x1 0x0 0x0 0x69 0x1 0x0 0x0 0x1 0x0 0x0 0x6a 0x1 0x0 0x0 0x1 0x0 0x0 0x6b 0x1 0x0 0x0 0x1 0x0 0x0 0x6c 0x1 0x0 0x0 0x1 0x0 0x0 0x6d 0x1 0x0 0x0 0x1 0x0 0x0 0x6e 0x1 0x0 0x0 0x1 0x1 0x1 0x6f 0x1 0x0 0x0 0x1 0x1 0x1 0x70 0x1 0x0 0x0 0x1 0x1 0x1 0x71 0x1 0x0 0x0 0x1 0x1 0x1 0x72 0x0 0x1 0x0 0x0 0x0 0x0 0x73 0x0 0x1 0x0 0x0 0x0 0x0 0x74 0x1 0x1 0x0 0x0 0x0 0x0 0x75 0x1 0x1 0x0 0x0 0x0 0x0 0x76 0x0 0x1 0x0 0x0 0x0 0x0 0x77 0x0 0x1 0x0 0x0 0x0 0x0 0x78 0x1 0x1 0x0 0x0 0x0 0x0 0x79 0x1 0x1 0x0 0x0 0x0 0x0 0x7a 0x0 0x1 0x0 0x0 0x0 0x0 0x7b 0x0 0x1 0x0 0x0 0x0 0x0 0x7c 0x0 0x1 0x0 0x0 0x0 0x0 0x7d 0x0 0x1 0x0 0x0 0x0 0x0 0x7e 0x0 0x1 0x0 0x0 0x0 0x0 0x7f 0x0 0x1 0x0 0x0 0x0 0x0 0x80 0x1 0x0 0x0 0x1 0x1 0x1 0x81 0x1 0x1 0x0 0x0 0x0 0x1 0x82 0x1 0x1 0x0 0x0 0x0 0x1 0x83 0x1 0x1 0x0 0x0 0x0 0x1 0x84 0x1 0x1 0x0 0x0 0x0 0x1 0x85 0x1 0x0 0x0 0x1 0x1 0x1 0x86 0x1 0x1 0x0 0x0 0x0 0x1 0x87 0x1 0x0 0x0 0x1 0x1 0x1 0x88 0x1 0x0 0x0 0x1 0x1 0x1 0x89 0x1 0x0 0x0 0x1 0x1 0x1 0x8a 0x1 0x0 0x0 0x1 0x1 0x1 0x8b 0x1 0x0 0x0 0x1 0x1 0x1 0x8c 0x1 0x0 0x0 0x1 0x1 0x1 0x8d 0x1 0x0 0x0 0x1 0x1 0x1 0x8e 0x1 0x1 0x0 0x0 0x0 0x0 0x8f 0x1 0x1 0x0 0x0 0x0 0x1 0x90 0x1 0x1 0x0 0x0 0x0 0x1 0x91 0x1 0x1 0x0 0x0 0x0 0x1 0x92 0x1 0x0 0x0 0x1 0x0 0x1 0x93 0x0 0x0 0x0 0x1 0x0 0x0 0x94 0x0 0x0 0x0 0x1 0x0 0x0 0x95 0x0 0x0 0x0 0x1 0x0 0x0 0x96 0x4 0x1 0x0 0x0 0x0 0x0 0x97 0x1 0x0 0x0 0x1 0x1 0x1 0x98 0x1 0x0 0x0 0x1 0x1 0x1 0x99 0x0 0x0 0x0 0x1 0x0 0x0 0x9a 0x1 0x0 0x0 0x0 0x0 0x1 0x9b 0x1 0x0 0x0 0x0 0x0 0x1 0x9c 0x0 0x1 0x0 0x0 0x0 0x0 0x9d 0x0 0x1 0x0 0x0 0x0 0x0 0x9e 0x0 0x1 0x0 0x0 0x0 0x0 0x9f 0x0 0x1 0x0 0x0 0x0 0x0 0xa0 0x0 0x1 0x0 0x0 0x0 0x0 0xa1 0x0 0x1 0x0 0x0 0x0 0x0 0xa2 0x0 0x1 0x0 0x0 0x0 0x0 0xa3 0x0 0x1 0x0 0x0 0x0 0x0 0xa4 0x0 0x1 0x0 0x0 0x0 0x0 0xa5 0x0 0x0 0x0 0x1 0x0 0x0 0xa6 0x0 0x0 0x0 0x1 0x0 0x0 0xb3 0x1 0x0 0x0 0x1 0x0 0x0 0xb4 0x1 0x0 0x0 0x1 0x0 0x0 0xb5 0x1 0x1 0x0 0x0 0x0 0x0 0xb6 0x1 0x1 0x0 0x0 0x0 0x0 0xb7 0x1 0x1 0x0 0x0 0x0 0x0 0xb8 0x1 0x0 0x0 0x1 0x0 0x0 0xb9 0x1 0x1 0x0 0x0 0x0 0x0 0xba 0x1 0x0 0x0 0x1 0x0 0x0 0xbb 0x1 0x1 0x0 0x0 0x0 0x0 0xbc 0x1 0x0 0x0 0x1 0x0 0x1 0xbd 0x1 0x1 0x0 0x0 0x0 0x1 0xbe 0x1 0x1 0x0 0x0 0x0 0x1 0xbf 0x1 0x1 0x0 0x0 0x0 0x1 0xc0 0x1 0x1 0x0 0x0 0x0 0x1 0xc1 0x1 0x0 0x0 0x1 0x0 0x1 0xc2 0x1 0x0 0x0 0x1 0x0 0x1 0xc3 0x0 0x1 0x0 0x0 0x0 0x0 0xc4 0x1 0x1 0x0 0x0 0x0 0x0 0xc5 0x0 0x1 0x0 0x0 0x0 0x0 0xc6 0x1 0x0 0x0 0x1 0x1 0x1 0xc7 0x1 0x0 0x0 0x1 0x1 0x1 0xc8 0x1 0x0 0x0 0x1 0x1 0x0 0xc9 0x1 0x1 0x0 0x0 0x0 0x0 0xca 0x0 0x1 0x0 0x0 0x0 0x0 0xcb 0x0 0x0 0x0 0x1 0x0 0x0 0xcc 0x0 0x0 0x0 0x1 0x0 0x0 0xcd 0x0 0x0 0x0 0x1 0x0 0x0 0xce 0x0 0x0 0x0 0x1 0x0 0x0 0xcf 0x0 0x0 0x0 0x1 0x0 0x0 0xd0 0x0 0x0 0x0 0x1 0x0 0x0 0xd1 0x0 0x0 0x0 0x1 0x0 0x0 0xd2 0x0 0x0 0x0 0x1 0x0 0x0>;
		};
	};

	fragment@31 {
		target = <0xffffffff>;

		__overlay__ {
			deb-gpios = <0xffffffff 0x0 0x0>;
			debounce = <0x7d000>;
			interrupt-parent = <0xffffffff>;
			interrupts = <0x0 0x8 0x0 0x0>;
			status = "okay";
		};
	};

	fragment@32 {
		target = <0xffffffff>;

		__overlay__ {
			interrupt-parent = <0xffffffff>;
			interrupts = <0x1 0x2 0x1 0x0>;
			status = "okay";
		};
	};

	fragment@33 {
		target = <0xffffffff>;

		__overlay__ {
			interrupt-parent = <0xffffffff>;
			interrupts = <0x7 0x2 0x7 0x0>;
			status = "okay";
		};
	};

	fragment@34 {
		target = <0xffffffff>;

		__overlay__ {
			interrupt-parent = <0xffffffff>;
			interrupts = <0x8 0x8 0x8 0x0>;
			status = "okay";
		};
	};

	fragment@35 {
		target = <0xffffffff>;

		__overlay__ {
			interrupt-parent = <0xffffffff>;
			interrupts = <0x9 0x1 0x9 0x0>;
			status = "okay";
		};
	};

	fragment@36 {
		target = <0xffffffff>;

		__overlay__ {
			interrupt-parent = <0xffffffff>;
			interrupts = <0xd 0x1 0xd 0x0>;
			status = "okay";
		};
	};

	fragment@37 {
		target = <0xffffffff>;

		__overlay__ {
			interrupt-parent = <0xffffffff>;
			interrupts = <0x10 0x2 0x10 0x0>;
			status = "okay";
		};
	};

	fragment@38 {
		target = <0xffffffff>;

		__overlay__ {
			interrupt-parent = <0xffffffff>;
			interrupts = <0x45 0x8 0x45 0x0>;
			status = "okay";
		};
	};

	fragment@39 {
		target = <0xffffffff>;

		__overlay__ {
			interrupt-parent = <0xffffffff>;
			interrupts = <0xc1 0x4 0xd1 0x0>;
			status = "okay";
		};
	};

	fragment@4 {
		target = <0xffffffff>;

		__overlay__ {
			status = "okay";

			nxp@28 {
				compatible = "qcom,nq-nci";
				interrupt-names = "nfc_irq";
				interrupt-parent = <0xffffffff>;
				interrupts = <0x58 0x4 0x58 0x0>;
				pinctrl-0 = <0x1>;
				pinctrl-1 = <0x2 0x3 0x4 0x5>;
				pinctrl-2 = <0x6 0x7 0x8 0x9>;
				pinctrl-names = "default", "nfc_active", "nfc_suspend";
				qcom,nq-clkreq = <0xffffffff 0x19 0x0>;
				qcom,nq-firm = <0xffffffff 0x57 0x0>;
				qcom,nq-irq = <0xffffffff 0x58 0x0>;
				qcom,nq-ven = <0xffffffff 0xa8 0x0>;
				reg = <0x28>;
			};
		};
	};

	fragment@40 {
		target = <0xffffffff>;

		__overlay__ {
			compatible = "mediatek,md1_sim1_hot_plug_eint-eint";
			debounce = <0x0 0x186a0>;
			dedicated = <0x0 0x0>;
			interrupts = <0x0 0x8>;
			sockettype = <0x0 0x0>;
			src_pin = <0x0 0x1>;
			status = "okay";
		};
	};

	fragment@41 {
		target = <0xffffffff>;

		__overlay__ {
			regulator-default-on = <0x1>;
			regulator-name = "vcamio";
			status = "okay";
		};
	};

	fragment@42 {
		target = <0xffffffff>;

		__overlay__ {
			regulator-default-on = <0x1>;
			regulator-name = "vtp";
			status = "okay";
		};
	};

	fragment@43 {
		target = <0xffffffff>;

		__overlay__ {
			status = "okay";
			vcamaf-supply = <0xffffffff>;
			vcamaf_main2-supply = <0xffffffff>;
			vcamaf_sub2-supply = <0xffffffff>;
			vcamio-supply = <0xffffffff>;
			vcamio_main2-supply = <0xffffffff>;
			vcamio_sub-supply = <0xffffffff>;
		};
	};

	fragment@44 {
		target = <0xffffffff>;

		__overlay__ {
			status = "okay";
		};
	};

	fragment@45 {
		target = <0xffffffff>;

		__overlay__ {
			mediatek,kpd-hw-dl-key0 = <0x0>;
			mediatek,kpd-hw-init-map = <0x73 0x72 0x0 0x0 0x0 0x0 0x0 0x0 0x0 0x0 0x0 0x0 0x0 0x0 0x0 0x0 0x0 0x0 0x0 0x0 0x0 0x0 0x0 0x0 0x0 0x0 0x0 0x0 0x0 0x0 0x0 0x0 0x0 0x0 0x0 0x0 0x0 0x0 0x0 0x0 0x0 0x0 0x0 0x0 0x0 0x0 0x0 0x0 0x0 0x0 0x0 0x0 0x0 0x0 0x0 0x0 0x0 0x0 0x0 0x0 0x0 0x0 0x0 0x0 0x0 0x0 0x0 0x0 0x0 0x0 0x0 0x0>;
			mediatek,kpd-hw-map-num = <0x48>;
			mediatek,kpd-hw-pwrkey = <0x8>;
			mediatek,kpd-key-debounce = <0x400>;
			mediatek,kpd-pwkey-gpio-din = <0x0>;
			mediatek,kpd-pwrkey-eint-gpio = <0x0>;
			mediatek,kpd-sw-pwrkey = <0x74>;
			mediatek,kpd-use-extend-type = <0x0>;
			status = "okay";
		};
	};

	fragment@46 {
		target = <0xffffffff>;

		__overlay__ {
			clock-frequency = <0x61a80>;
			pinctrl-0 = <0x26>;
			pinctrl-1 = <0x27>;
			pinctrl-2 = <0x28>;
			pinctrl-3 = <0x29>;
			pinctrl-4 = <0x2a>;
			pinctrl-5 = <0x2b>;
			pinctrl-6 = <0x2c>;
			pinctrl-names = "default", "ts_int_active", "ts_reset_active", "ts_int_suspend", "ts_reset_suspend", "ts_i2c_mode", "ts_eint_high";

			gt1151@14 {
				compatible = "goodix,gt1151";
				reg = <0x14>;
				status = "okay";
			};

			gt9886@5d {
				compatible = "goodix,gt9886";
				goodix,config-version = "6785v99";
				goodix,firmware-version = "6785ae";
				goodix,input-max-x = <0x438>;
				goodix,input-max-y = <0x870>;
				goodix,irq-flags = <0x2>;
				goodix,irq-gpio = <0xffffffff 0x1 0x0>;
				goodix,key-of-pen = <0x14b 0x14c>;
				goodix,panel-key-map = <0x9e 0xac 0xd9>;
				goodix,panel-max-id = <0xa>;
				goodix,panel-max-p = <0x100>;
				goodix,panel-max-w = <0x100>;
				goodix,panel-max-x = <0x438>;
				goodix,panel-max-y = <0x870>;
				goodix,pen-enable;
				goodix,power-off-delay-us = <0x1388>;
				goodix,power-on-delay-us = <0x2710>;
				goodix,reset-gpio = <0xffffffff 0x2 0x0>;
				interrupt-parent = <0xffffffff>;
				interrupts = <0x1 0x2 0x1 0x0>;
				reg = <0x5d>;
				status = "okay";
				tpd-filter-custom-prameters = <0x0 0x0 0x0 0x0 0x0 0x0 0x0 0x0 0x0 0x0 0x0 0x0>;
				tpd-filter-custom-speed = <0x0 0x0 0x0>;
				tpd-filter-enable = <0x0>;
				tpd-filter-pixel-density = <0xa1>;
				vtouch-supply = <0xffffffff>;
			};
		};
	};

	fragment@47 {
		target = <0xffffffff>;

		__overlay__ {
			goodix,eint-gpio = <0xffffffff 0x1 0x0>;
			goodix,reset-gpio = <0xffffffff 0x2 0x0>;
			interrupt-parent = <0xffffffff>;
			interrupts = <0x1 0x2 0x1 0x0>;
			lcm-resolution = <0x438 0x870>;
			status = "okay";
			tpd-cfg-version = "config19";
			tpd-filter-custom-prameters = <0x0 0x0 0x0 0x0 0x0 0x0 0x0 0x0 0x0 0x0 0x0 0x0>;
			tpd-filter-custom-speed = <0x0 0x0 0x0>;
			tpd-filter-enable = <0x0>;
			tpd-filter-pixel-density = <0xa8>;
			tpd-max-touch-num = <0xa>;
			tpd-resolution = <0x438 0x870>;
			vtouch-supply = <0xffffffff>;
		};
	};

	fragment@48 {
		target = <0xffffffff>;

		__overlay__ {

			eintdefault {
				phandle = <0x26>;
			};

			i2cmode_default {
				phandle = <0x2b>;

				pins_cmd_dat {
					pinmux = <0x3301 0x3401>;
				};
			};

			int_active {
				phandle = <0x27>;

				pins_cmd_dat {
					bias-pill-up = <0x67>;
					input-enable;
					pinmux = <0x100>;
				};
			};

			int_high {
				phandle = <0x2c>;

				pins_cmd_dat {
					output-high;
					pinmux = <0x100>;
				};
			};

			int_suspend {
				phandle = <0x29>;

				pins_cmd_dat {
					output-low;
					pinmux = <0x100>;
				};
			};

			reset_active {
				phandle = <0x28>;

				pins_cmd_dat {
					output-high;
					pinmux = <0x200>;
				};
			};

			reset_suspend {
				phandle = <0x2a>;

				pins_cmd_dat {
					output-low;
					pinmux = <0x200>;
				};
			};
		};
	};

	fragment@49 {
		target = <0xffffffff>;

		__overlay__ {

			ts_int_active {
				phandle = <0x2d>;

				pins_cmd_dat {
					bias-pull-down = <0xb>;
					pinmux = <0x100>;
					slew-rate = <0x0>;
				};
			};

			ts_int_suspend {
				phandle = <0x2f>;

				pins_cmd_dat {
					bias-disable;
					pinmux = <0x100>;
					slew-rate = <0x0>;
				};
			};

			ts_reset_active {
				phandle = <0x2e>;

				pins_cmd_dat {
					bias-pull-up = <0xb>;
					output-high;
					pinmux = <0x200>;
					slew-rate = <0x0>;
				};
			};

			ts_reset_suspend {
				phandle = <0x30>;

				pins_cmd_dat {
					bias-disable;
					output-low;
					pinmux = <0x200>;
					slew-rate = <0x0>;
				};
			};
		};
	};

	fragment@5 {
		target = <0xffffffff>;

		__overlay__ {
			accdet-mic-mode = <0x2>;
			accdet-mic-vol = <0x8>;
			accdet-plugout-debounce = <0x1>;
			eint_use_ext_res = <0x4>;
			headset-four-key-threshold = <0x0 0x3a 0x79 0xc0 0x190>;
			headset-mode-setting = <0x500 0x500 0x1 0x1f0 0x800 0x1000 0x20 0x44 0x4 0x1 0x5 0x3 0x3 0x7 0xe>;
			headset-three-key-threshold = <0x0 0x50 0xdc 0x190>;
			headset-three-key-threshold-CDD = <0x0 0x79 0xc0 0x258>;
			status = "okay";
		};
	};

	fragment@50 {
		target = <0xffffffff>;

		__overlay__ {
			compatible = "novatek,NVT-ts-spi";
			novatek,config-array-size = <0x2>;
			novatek,irq-gpio = <0xffffffff 0x1 0x2001>;
			novatek,reset-gpio = <0xffffffff 0x2 0x0>;
			novatek,reset-tddi = <0xffffffff 0x2c 0x0>;
			novatek,spi-rd-fast-addr = <0x3f310>;
			novatek,swrst-n8-addr = <0x3f0fe>;
			pinctrl-0 = <0x2d 0x2e>;
			pinctrl-1 = <0x2f 0x30>;
			pinctrl-names = "pmx_ts_active", "pmx_ts_suspend";
			spi-max-frequency = <0x4c4b40>;
			status = "ok";

			novatek,cfg_0 {
				novatek,clicknum-file-name = "nvt+csot";
				novatek,display-maker = <0x42>;
				novatek,fw-name = "novatek_nt36672a_g7_fw01.bin";
				novatek,mp-name = "novatek_nt36672a_g7_mp01.bin";
				novatek,tp-vendor = <0x53>;
			};

			novatek,cfg_1 {
				novatek,clicknum-file-name = "nvt+tianma";
				novatek,display-maker = <0x36>;
				novatek,fw-name = "novatek_nt36672a_g7_fw02.bin";
				novatek,mp-name = "novatek_nt36672a_g7_mp02.bin";
				novatek,tp-vendor = <0x46>;
			};

			novatek-mp-criteria-nvtpid@0 {
				#address-cells = <0x1>;
				#size-cells = <0x0>;
				AIN_KEY = <0x0 0x1 0x2 0xff>;
				AIN_X = <0x0 0x1 0x2 0x3 0x4 0x5 0x6 0x7 0x8 0x9 0xa 0xb 0xc 0xd 0xe 0xf 0x10 0x11>;
				AIN_Y = <0x0 0x1 0x2 0x3 0x4 0x5 0x6 0x7 0x8 0x9 0xa 0xb 0xc 0xd 0xe 0xf 0x10 0x11 0x12 0x13 0x14 0x15 0x16 0x17 0x18 0x19 0x1a 0x1b 0x1c 0x1d 0x1e 0x1f 0x20 0x21 0x22 0x23>;
				IC_KEY_CFG_SIZE = <0x4>;
				IC_X_CFG_SIZE = <0x12>;
				IC_Y_CFG_SIZE = <0x24>;
				PS_Config_Diff_Test_Frame = <0x32>;
				PS_Config_Lmt_FW_CC_N = <0x1e 0x1e 0x1e 0x1e 0x1e 0x1e 0x1e 0x1e 0x1e 0x1e 0x1e 0x1e 0x1e 0x1e 0x1e 0x1e 0x1e 0x1e 0x1e 0x1e 0x1e 0x1e 0x1e 0x1e 0x1e 0x1e 0x1e 0x1e 0x1e 0x1e 0x1e 0x1e 0x1e 0x1e 0x1e 0x1e 0x1e 0x1e 0x1e 0x1e 0x1e 0x1e 0x1e 0x1e 0x1e 0x1e 0x1e 0x1e 0x1e 0x1e 0x1e 0x1e 0x1e 0x1e 0x1e 0x1e 0x1e 0x1e 0x1e 0x1e 0x1e 0x1e 0x1e 0x1e 0x1e 0x1e 0x1e 0x1e 0x1e 0x1e 0x1e 0x1e 0x1e 0x1e 0x1e 0x1e 0x1e 0x1e 0x1e 0x1e 0x1e 0x1e 0x1e 0x1e 0x1e 0x1e 0x1e 0x1e 0x1e 0x1e 0x1e 0x1e 0x1e 0x1e 0x1e 0x1e 0x1e 0x1e 0x1e 0x1e 0x1e 0x1e 0x1e 0x1e 0x1e 0x1e 0x1e 0x1e 0x1e 0x1e 0x1e 0x1e 0x1e 0x1e 0x1e 0x1e 0x1e 0x1e 0x1e 0x1e 0x1e 0x1e 0x1e 0x1e 0x1e 0x1e 0x1e 0x1e 0x1e 0x1e 0x1e 0x1e 0x1e 0x1e 0x1e 0x1e 0x1e 0x1e 0x1e 0x1e 0x1e 0x1e 0x1e 0x1e 0x1e 0x1e 0x1e 0x1e 0x1e 0x1e 0x1e 0x1e 0x1e 0x1e 0x1e 0x1e 0x1e 0x1e 0x1e 0x1e 0x1e 0x1e 0x1e 0x1e 0x1e 0x1e 0x1e 0x1e 0x1e 0x1e 0x1e 0x1e 0x1e 0x1e 0x1e 0x1e 0x1e 0x1e 0x1e 0x1e 0x1e 0x1e 0x1e 0x1e 0x1e 0x1e 0x1e 0x1e 0x1e 0x1e 0x1e 0x1e 0x1e 0x1e 0x1e 0x1e 0x1e 0x1e 0x1e 0x1e 0x1e 0x1e 0x1e 0x1e 0x1e 0x1e 0x1e 0x1e 0x1e 0x1e 0x1e 0x1e 0x1e 0x1e 0x1e 0x1e 0x1e 0x1e 0x1e 0x1e 0x1e 0x1e 0x1e 0x1e 0x1e 0x1e 0x1e 0x1e 0x1e 0x1e 0x1e 0x1e 0x1e 0x1e 0x1e 0x1e 0x1e 0x1e 0x1e 0x1e 0x1e 0x1e 0x1e 0x1e 0x1e 0x1e 0x1e 0x1e 0x1e 0x1e 0x1e 0x1e 0x1e 0x1e 0x1e 0x1e 0x1e 0x1e 0x1e 0x1e 0x1e 0x1e 0x1e 0x1e 0x1e 0x1e 0x1e 0x1e 0x1e 0x1e 0x1e 0x1e 0x1e 0x1e 0x1e 0x1e 0x1e 0x1e 0x1e 0x1e 0x1e 0x1e 0x1e 0x1e 0x1e 0x1e 0x1e 0x1e 0x1e 0x1e 0x1e 0x1e 0x1e 0x1e 0x1e 0x1e 0x1e 0x1e 0x1e 0x1e 0x1e 0x1e 0x1e 0x1e 0x1e 0x1e 0x1e 0x1e 0x1e 0x1e 0x1e 0x1e 0x1e 0x1e 0x1e 0x1e 0x1e 0x1e 0x1e 0x1e 0x1e 0x1e 0x1e 0x1e 0x1e 0x1e 0x1e 0x1e 0x1e 0x1e 0x1e 0x1e 0x1e 0x1e 0x1e 0x1e 0x1e 0x1e 0x1e 0x1e 0x1e 0x1e 0x1e 0x1e 0x1e 0x1e 0x1e 0x1e 0x1e 0x1e 0x1e 0x1e 0x1e 0x1e 0x1e 0x1e 0x1e 0x1e 0x1e 0x1e 0x1e 0x1e 0x1e 0x1e 0x1e 0x1e 0x1e 0x1e 0x1e 0x1e 0x1e 0x1e 0x1e 0x1e 0x1e 0x1e 0x1e 0x1e 0x1e 0x1e 0x1e 0x1e 0x1e 0x1e 0x1e 0x1e 0x1e 0x1e 0x1e 0x1e 0x1e 0x1e 0x1e 0x1e 0x1e 0x1e 0x1e 0x1e 0x1e 0x1e 0x1e 0x1e 0x1e 0x1e 0x1e 0x1e 0x1e 0x1e 0x1e 0x1e 0x1e 0x1e 0x1e 0x1e 0x1e 0x1e 0x1e 0x1e 0x1e 0x1e 0x1e 0x1e 0x1e 0x1e 0x1e 0x1e 0x1e 0x1e 0x1e 0x1e 0x1e 0x1e 0x1e 0x1e 0x1e 0x1e 0x1e 0x1e 0x1e 0x1e 0x1e 0x1e 0x1e 0x1e 0x1e 0x1e 0x1e 0x1e 0x1e 0x1e 0x1e 0x1e 0x1e 0x1e 0x1e 0x1e 0x1e 0x1e 0x1e 0x1e 0x1e 0x1e 0x1e 0x1e 0x1e 0x1e 0x1e 0x1e 0x1e 0x1e 0x1e 0x1e 0x1e 0x1e 0x1e 0x1e 0x1e 0x1e 0x1e 0x1e 0x1e 0x1e 0x1e 0x1e 0x1e 0x1e 0x1e 0x1e 0x1e 0x1e 0x1e 0x1e 0x1e 0x1e 0x1e 0x1e 0x1e 0x1e 0x1e 0x1e 0x1e 0x1e 0x1e 0x1e 0x1e 0x1e 0x1e 0x1e 0x1e 0x1e 0x1e 0x1e 0x1e 0x1e 0x1e 0x1e 0x1e 0x1e 0x1e 0x1e 0x1e 0x1e 0x1e 0x1e 0x1e 0x1e 0x1e 0x1e 0x1e 0x1e 0x1e 0x1e 0x1e 0x1e 0x1e 0x1e 0x1e 0x1e 0x1e 0x1e 0x1e 0x1e 0x1e 0x1e 0x1e 0x1e 0x1e 0x1e 0x1e 0x1e 0x1e 0x1e 0x1e 0x1e 0x1e 0x1e 0x1e 0x1e 0x1e 0x1e 0x1e 0x1e 0x1e 0x1e 0x1e 0x1e 0x1e 0x1e 0x1e 0x1e 0x1e 0x1e 0x1e 0x1e 0x1e 0x1e 0x1e 0x1e 0x1e 0x1e 0x1e 0x1e 0x1e 0x1e 0x1e 0x1e 0x1e 0x1e 0x1e 0x1e 0x1e 0x1e 0x1e 0x1e 0x1e 0x1e 0x1e 0x1e 0x1e 0x1e 0x1e 0x1e 0x1e 0x1e 0x1e 0x1e 0x1e 0x1e 0x1e 0x1e 0x1e 0x1e 0x1e 0x1e 0x1e 0x1e 0x1e 0x1e 0x1e 0x1e 0x1e 0x1e 0x1e 0x1e 0x1e 0x1e 0x1e 0x1e 0x1e 0x1e 0x1e 0x1e 0x1e 0x1e 0x1e 0x1e 0x1e 0x1e 0x1e 0x1e 0x1e 0x1e 0x1e 0x1e 0x1e 0x1e 0x1e 0x1e 0x1e 0x1e 0x1e>;
				PS_Config_Lmt_FW_CC_P = <0x13a 0x13a 0x13a 0x13a 0x13a 0x13a 0x13a 0x13a 0x13a 0x13a 0x13a 0x13a 0x13a 0x13a 0x13a 0x13a 0x13a 0x13a 0x13a 0x13a 0x13a 0x13a 0x13a 0x13a 0x13a 0x13a 0x13a 0x13a 0x13a 0x13a 0x13a 0x13a 0x13a 0x13a 0x13a 0x13a 0x13a 0x13a 0x13a 0x13a 0x13a 0x13a 0x13a 0x13a 0x13a 0x13a 0x13a 0x13a 0x13a 0x13a 0x13a 0x13a 0x13a 0x13a 0x13a 0x13a 0x13a 0x13a 0x13a 0x13a 0x13a 0x13a 0x13a 0x13a 0x13a 0x13a 0x13a 0x13a 0x13a 0x13a 0x13a 0x13a 0x13a 0x13a 0x13a 0x13a 0x13a 0x13a 0x13a 0x13a 0x13a 0x13a 0x13a 0x13a 0x13a 0x13a 0x13a 0x13a 0x13a 0x13a 0x13a 0x13a 0x13a 0x13a 0x13a 0x13a 0x13a 0x13a 0x13a 0x13a 0x13a 0x13a 0x13a 0x13a 0x13a 0x13a 0x13a 0x13a 0x13a 0x13a 0x13a 0x13a 0x13a 0x13a 0x13a 0x13a 0x13a 0x13a 0x13a 0x13a 0x13a 0x13a 0x13a 0x13a 0x13a 0x13a 0x13a 0x13a 0x13a 0x13a 0x13a 0x13a 0x13a 0x13a 0x13a 0x13a 0x13a 0x13a 0x13a 0x13a 0x13a 0x13a 0x13a 0x13a 0x13a 0x13a 0x13a 0x13a 0x13a 0x13a 0x13a 0x13a 0x13a 0x13a 0x13a 0x13a 0x13a 0x13a 0x13a 0x13a 0x13a 0x13a 0x13a 0x13a 0x13a 0x13a 0x13a 0x13a 0x13a 0x13a 0x13a 0x13a 0x13a 0x13a 0x13a 0x13a 0x13a 0x13a 0x13a 0x13a 0x13a 0x13a 0x13a 0x13a 0x13a 0x13a 0x13a 0x13a 0x13a 0x13a 0x13a 0x13a 0x13a 0x13a 0x13a 0x13a 0x13a 0x13a 0x13a 0x13a 0x13a 0x13a 0x13a 0x13a 0x13a 0x13a 0x13a 0x13a 0x13a 0x13a 0x13a 0x13a 0x13a 0x13a 0x13a 0x13a 0x13a 0x13a 0x13a 0x13a 0x13a 0x13a 0x13a 0x13a 0x13a 0x13a 0x13a 0x13a 0x13a 0x13a 0x13a 0x13a 0x13a 0x13a 0x13a 0x13a 0x13a 0x13a 0x13a 0x13a 0x13a 0x13a 0x13a 0x13a 0x13a 0x13a 0x13a 0x13a 0x13a 0x13a 0x13a 0x13a 0x13a 0x13a 0x13a 0x13a 0x13a 0x13a 0x13a 0x13a 0x13a 0x13a 0x13a 0x13a 0x13a 0x13a 0x13a 0x13a 0x13a 0x13a 0x13a 0x13a 0x13a 0x13a 0x13a 0x13a 0x13a 0x13a 0x13a 0x13a 0x13a 0x13a 0x13a 0x13a 0x13a 0x13a 0x13a 0x13a 0x13a 0x13a 0x13a 0x13a 0x13a 0x13a 0x13a 0x13a 0x13a 0x13a 0x13a 0x13a 0x13a 0x13a 0x13a 0x13a 0x13a 0x13a 0x13a 0x13a 0x13a 0x13a 0x13a 0x13a 0x13a 0x13a 0x13a 0x13a 0x13a 0x13a 0x13a 0x13a 0x13a 0x13a 0x13a 0x13a 0x13a 0x13a 0x13a 0x13a 0x13a 0x13a 0x13a 0x13a 0x13a 0x13a 0x13a 0x13a 0x13a 0x13a 0x13a 0x13a 0x13a 0x13a 0x13a 0x13a 0x13a 0x13a 0x13a 0x13a 0x13a 0x13a 0x13a 0x13a 0x13a 0x13a 0x13a 0x13a 0x13a 0x13a 0x13a 0x13a 0x13a 0x13a 0x13a 0x13a 0x13a 0x13a 0x13a 0x13a 0x13a 0x13a 0x13a 0x13a 0x13a 0x13a 0x13a 0x13a 0x13a 0x13a 0x13a 0x13a 0x13a 0x13a 0x13a 0x13a 0x13a 0x13a 0x13a 0x13a 0x13a 0x13a 0x13a 0x13a 0x13a 0x13a 0x13a 0x13a 0x13a 0x13a 0x13a 0x13a 0x13a 0x13a 0x13a 0x13a 0x13a 0x13a 0x13a 0x13a 0x13a 0x13a 0x13a 0x13a 0x13a 0x13a 0x13a 0x13a 0x13a 0x13a 0x13a 0x13a 0x13a 0x13a 0x13a 0x13a 0x13a 0x13a 0x13a 0x13a 0x13a 0x13a 0x13a 0x13a 0x13a 0x13a 0x13a 0x13a 0x13a 0x13a 0x13a 0x13a 0x13a 0x13a 0x13a 0x13a 0x13a 0x13a 0x13a 0x13a 0x13a 0x13a 0x13a 0x13a 0x13a 0x13a 0x13a 0x13a 0x13a 0x13a 0x13a 0x13a 0x13a 0x13a 0x13a 0x13a 0x13a 0x13a 0x13a 0x13a 0x13a 0x13a 0x13a 0x13a 0x13a 0x13a 0x13a 0x13a 0x13a 0x13a 0x13a 0x13a 0x13a 0x13a 0x13a 0x13a 0x13a 0x13a 0x13a 0x13a 0x13a 0x13a 0x13a 0x13a 0x13a 0x13a 0x13a 0x13a 0x13a 0x13a 0x13a 0x13a 0x13a 0x13a 0x13a 0x13a 0x13a 0x13a 0x13a 0x13a 0x13a 0x13a 0x13a 0x13a 0x13a 0x13a 0x13a 0x13a 0x13a 0x13a 0x13a 0x13a 0x13a 0x13a 0x13a 0x13a 0x13a 0x13a 0x13a 0x13a 0x13a 0x13a 0x13a 0x13a 0x13a 0x13a 0x13a 0x13a 0x13a 0x13a 0x13a 0x13a 0x13a 0x13a 0x13a 0x13a 0x13a 0x13a 0x13a 0x13a 0x13a 0x13a 0x13a 0x13a 0x13a 0x13a 0x13a 0x13a 0x13a 0x13a 0x13a 0x13a 0x13a 0x13a 0x13a 0x13a 0x13a 0x13a 0x13a 0x13a 0x13a 0x13a 0x13a 0x13a 0x13a 0x13a 0x13a 0x13a 0x13a 0x13a 0x13a 0x13a 0x13a 0x13a 0x13a 0x13a 0x13a 0x13a 0x13a 0x13a 0x13a 0x13a 0x13a 0x13a 0x13a 0x13a 0x13a 0x13a 0x13a 0x13a 0x13a 0x13a 0x13a 0x13a 0x13a 0x13a 0x13a 0x13a 0x13a 0x13a 0x13a 0x13a 0x13a 0x13a 0x13a 0x13a 0x13a 0x13a 0x13a 0x13a 0x13a 0x13a 0x13a 0x13a 0x13a 0x13a 0x13a 0x13a 0x13a 0x13a 0x13a 0x13a 0x13a 0x13a 0x13a 0x13a 0x13a 0x13a 0x13a 0x13a 0x13a 0x13a 0x13a 0x13a 0x13a 0x13a 0x13a 0x13a 0x13a 0x13a 0x13a 0x13a 0x13a>;
				PS_Config_Lmt_FW_Diff_N = <0xffffffb5 0xffffffb5 0xffffffb5 0xffffffb5 0xffffffb5 0xffffffb5 0xffffffb5 0xffffffb5 0xffffffb5 0xffffffb5 0xffffffb5 0xffffffb5 0xffffffb5 0xffffffb5 0xffffffb5 0xffffffb5 0xffffffb5 0xffffffb5 0xffffffb5 0xffffffb5 0xffffffb5 0xffffffb5 0xffffffb5 0xffffffb5 0xffffffb5 0xffffffb5 0xffffffb5 0xffffffb5 0xffffffb5 0xffffffb5 0xffffffb5 0xffffffb5 0xffffffb5 0xffffffb5 0xffffffb5 0xffffffb5 0xffffffb5 0xffffffb5 0xffffffb5 0xffffffb5 0xffffffb5 0xffffffb5 0xffffffb5 0xffffffb5 0xffffffb5 0xffffffb5 0xffffffb5 0xffffffb5 0xffffffb5 0xffffffb5 0xffffffb5 0xffffffb5 0xffffffb5 0xffffffb5 0xffffffb5 0xffffffb5 0xffffffb5 0xffffffb5 0xffffffb5 0xffffffb5 0xffffffb5 0xffffffb5 0xffffffb5 0xffffffb5 0xffffffb5 0xffffffb5 0xffffffb5 0xffffffb5 0xffffffb5 0xffffffb5 0xffffffb5 0xffffffb5 0xffffffb5 0xffffffb5 0xffffffb5 0xffffffb5 0xffffffb5 0xffffffb5 0xffffffb5 0xffffffb5 0xffffffb5 0xffffffb5 0xffffffb5 0xffffffb5 0xffffffb5 0xffffffb5 0xffffffb5 0xffffffb5 0xffffffb5 0xffffffb5 0xffffffb5 0xffffffb5 0xffffffb5 0xffffffb5 0xffffffb5 0xffffffb5 0xffffffb5 0xffffffb5 0xffffffb5 0xffffffb5 0xffffffb5 0xffffffb5 0xffffffb5 0xffffffb5 0xffffffb5 0xffffffb5 0xffffffb5 0xffffffb5 0xffffffb5 0xffffffb5 0xffffffb5 0xffffffb5 0xffffffb5 0xffffffb5 0xffffffb5 0xffffffb5 0xffffffb5 0xffffffb5 0xffffffb5 0xffffffb5 0xffffffb5 0xffffffb5 0xffffffb5 0xffffffb5 0xffffffb5 0xffffffb5 0xffffffb5 0xffffffb5 0xffffffb5 0xffffffb5 0xffffffb5 0xffffffb5 0xffffffb5 0xffffffb5 0xffffffb5 0xffffffb5 0xffffffb5 0xffffffb5 0xffffffb5 0xffffffb5 0xffffffb5 0xffffffb5 0xffffffb5 0xffffffb5 0xffffffb5 0xffffffb5 0xffffffb5 0xffffffb5 0xffffffb5 0xffffffb5 0xffffffb5 0xffffffb5 0xffffffb5 0xffffffb5 0xffffffb5 0xffffffb5 0xffffffb5 0xffffffb5 0xffffffb5 0xffffffb5 0xffffffb5 0xffffffb5 0xffffffb5 0xffffffb5 0xffffffb5 0xffffffb5 0xffffffb5 0xffffffb5 0xffffffb5 0xffffffb5 0xffffffb5 0xffffffb5 0xffffffb5 0xffffffb5 0xffffffb5 0xffffffb5 0xffffffb5 0xffffffb5 0xffffffb5 0xffffffb5 0xffffffb5 0xffffffb5 0xffffffb5 0xffffffb5 0xffffffb5 0xffffffb5 0xffffffb5 0xffffffb5 0xffffffb5 0xffffffb5 0xffffffb5 0xffffffb5 0xffffffb5 0xffffffb5 0xffffffb5 0xffffffb5 0xffffffb5 0xffffffb5 0xffffffb5 0xffffffb5 0xffffffb5 0xffffffb5 0xffffffb5 0xffffffb5 0xffffffb5 0xffffffb5 0xffffffb5 0xffffffb5 0xffffffb5 0xffffffb5 0xffffffb5 0xffffffb5 0xffffffb5 0xffffffb5 0xffffffb5 0xffffffb5 0xffffffb5 0xffffffb5 0xffffffb5 0xffffffb5 0xffffffb5 0xffffffb5 0xffffffb5 0xffffffb5 0xffffffb5 0xffffffb5 0xffffffb5 0xffffffb5 0xffffffb5 0xffffffb5 0xffffffb5 0xffffffb5 0xffffffb5 0xffffffb5 0xffffffb5 0xffffffb5 0xffffffb5 0xffffffb5 0xffffffb5 0xffffffb5 0xffffffb5 0xffffffb5 0xffffffb5 0xffffffb5 0xffffffb5 0xffffffb5 0xffffffb5 0xffffffb5 0xffffffb5 0xffffffb5 0xffffffb5 0xffffffb5 0xffffffb5 0xffffffb5 0xffffffb5 0xffffffb5 0xffffffb5 0xffffffb5 0xffffffb5 0xffffffb5 0xffffffb5 0xffffffb5 0xffffffb5 0xffffffb5 0xffffffb5 0xffffffb5 0xffffffb5 0xffffffb5 0xffffffb5 0xffffffb5 0xffffffb5 0xffffffb5 0xffffffb5 0xffffffb5 0xffffffb5 0xffffffb5 0xffffffb5 0xffffffb5 0xffffffb5 0xffffffb5 0xffffffb5 0xffffffb5 0xffffffb5 0xffffffb5 0xffffffb5 0xffffffb5 0xffffffb5 0xffffffb5 0xffffffb5 0xffffffb5 0xffffffb5 0xffffffb5 0xffffffb5 0xffffffb5 0xffffffb5 0xffffffb5 0xffffffb5 0xffffffb5 0xffffffb5 0xffffffb5 0xffffffb5 0xffffffb5 0xffffffb5 0xffffffb5 0xffffffb5 0xffffffb5 0xffffffb5 0xffffffb5 0xffffffb5 0xffffffb5 0xffffffb5 0xffffffb5 0xffffffb5 0xffffffb5 0xffffffb5 0xffffffb5 0xffffffb5 0xffffffb5 0xffffffb5 0xffffffb5 0xffffffb5 0xffffffb5 0xffffffb5 0xffffffb5 0xffffffb5 0xffffffb5 0xffffffb5 0xffffffb5 0xffffffb5 0xffffffb5 0xffffffb5 0xffffffb5 0xffffffb5 0xffffffb5 0xffffffb5 0xffffffb5 0xffffffb5 0xffffffb5 0xffffffb5 0xffffffb5 0xffffffb5 0xffffffb5 0xffffffb5 0xffffffb5 0xffffffb5 0xffffffb5 0xffffffb5 0xffffffb5 0xffffffb5 0xffffffb5 0xffffffb5 0xffffffb5 0xffffffb5 0xffffffb5 0xffffffb5 0xffffffb5 0xffffffb5 0xffffffb5 0xffffffb5 0xffffffb5 0xffffffb5 0xffffffb5 0xffffffb5 0xffffffb5 0xffffffb5 0xffffffb5 0xffffffb5 0xffffffb5 0xffffffb5 0xffffffb5 0xffffffb5 0xffffffb5 0xffffffb5 0xffffffb5 0xffffffb5 0xffffffb5 0xffffffb5 0xffffffb5 0xffffffb5 0xffffffb5 0xffffffb5 0xffffffb5 0xffffffb5 0xffffffb5 0xffffffb5 0xffffffb5 0xffffffb5 0xffffffb5 0xffffffb5 0xffffffb5 0xffffffb5 0xffffffb5 0xffffffb5 0xffffffb5 0xffffffb5 0xffffffb5 0xffffffb5 0xffffffb5 0xffffffb5 0xffffffb5 0xffffffb5 0xffffffb5 0xffffffb5 0xffffffb5 0xffffffb5 0xffffffb5 0xffffffb5 0xffffffb5 0xffffffb5 0xffffffb5 0xffffffb5 0xffffffb5 0xffffffb5 0xffffffb5 0xffffffb5 0xffffffb5 0xffffffb5 0xffffffb5 0xffffffb5 0xffffffb5 0xffffffb5 0xffffffb5 0xffffffb5 0xffffffb5 0xffffffb5 0xffffffb5 0xffffffb5 0xffffffb5 0xffffffb5 0xffffffb5 0xffffffb5 0xffffffb5 0xffffffb5 0xffffffb5 0xffffffb5 0xffffffb5 0xffffffb5 0xffffffb5 0xffffffb5 0xffffffb5 0xffffffb5 0xffffffb5 0xffffffb5 0xffffffb5 0xffffffb5 0xffffffb5 0xffffffb5 0xffffffb5 0xffffffb5 0xffffffb5 0xffffffb5 0xffffffb5 0xffffffb5 0xffffffb5 0xffffffb5 0xffffffb5 0xffffffb5 0xffffffb5 0xffffffb5 0xffffffb5 0xffffffb5 0xffffffb5 0xffffffb5 0xffffffb5 0xffffffb5 0xffffffb5 0xffffffb5 0xffffffb5 0xffffffb5 0xffffffb5 0xffffffb5 0xffffffb5 0xffffffb5 0xffffffb5 0xffffffb5 0xffffffb5 0xffffffb5 0xffffffb5 0xffffffb5 0xffffffb5 0xffffffb5 0xffffffb5 0xffffffb5 0xffffffb5 0xffffffb5 0xffffffb5 0xffffffb5 0xffffffb5 0xffffffb5 0xffffffb5 0xffffffb5 0xffffffb5 0xffffffb5 0xffffffb5 0xffffffb5 0xffffffb5 0xffffffb5 0xffffffb5 0xffffffb5 0xffffffb5 0xffffffb5 0xffffffb5 0xffffffb5 0xffffffb5 0xffffffb5 0xffffffb5 0xffffffb5 0xffffffb5 0xffffffb5 0xffffffb5 0xffffffb5 0xffffffb5 0xffffffb5 0xffffffb5 0xffffffb5 0xffffffb5 0xffffffb5 0xffffffb5 0xffffffb5 0xffffffb5 0xffffffb5 0xffffffb5 0xffffffb5 0xffffffb5 0xffffffb5 0xffffffb5 0xffffffb5 0xffffffb5 0xffffffb5 0xffffffb5 0xffffffb5 0xffffffb5 0xffffffb5 0xffffffb5 0xffffffb5 0xffffffb5 0xffffffb5 0xffffffb5 0xffffffb5 0xffffffb5 0xffffffb5 0xffffffb5 0xffffffb5 0xffffffb5 0xffffffb5 0xffffffb5 0xffffffb5 0xffffffb5 0xffffffb5 0xffffffb5 0xffffffb5 0xffffffb5 0xffffffb5 0xffffffb5 0xffffffb5 0xffffffb5 0xffffffb5 0xffffffb5 0xffffffb5 0xffffffb5 0xffffffb5 0xffffffb5 0xffffffb5 0xffffffb5 0xffffffb5 0xffffffb5 0xffffffb5 0xffffffb5 0xffffffb5 0xffffffb5 0xffffffb5 0xffffffb5 0xffffffb5 0xffffffb5 0xffffffb5 0xffffffb5 0xffffffb5 0xffffffb5 0xffffffb5 0xffffffb5 0xffffffb5 0xffffffb5 0xffffffb5 0xffffffb5 0xffffffb5 0xffffffb5 0xffffffb5 0xffffffb5 0xffffffb5 0xffffffb5 0xffffffb5 0xffffffb5 0xffffffb5 0xffffffb5 0xffffffb5 0xffffffb5 0xffffffb5 0xffffffb5 0xffffffb5 0xffffffb5 0xffffffb5 0xffffffb5 0xffffffb5 0xffffffb5 0xffffffb5 0xffffffb5 0xffffffb5 0xffffffb5 0xffffffb5 0xffffffb5 0xffffffb5 0xffffffb5 0xffffffb5 0xffffffb5 0xffffffb5 0xffffffb5 0xffffffb5 0xffffffb5 0xffffffb5 0xffffffb5 0xffffffb5 0xffffffb5 0xffffffb5 0xffffffb5 0xffffffb5 0xffffffb5 0xffffffb5 0xffffffb5 0xffffffb5 0xffffffb5 0xffffffb5 0xffffffb5 0xffffffb5 0xffffffb5 0xffffffb5 0xffffffb5 0xffffffb5 0xffffffb5 0xffffffb5 0xffffffb5 0xffffffb5 0xffffffb5 0xffffffb5 0xffffffb5 0xffffffb5 0xffffffb5 0xffffffb5 0xffffffb5 0xffffffb5 0xffffffb5 0xffffffb5>;
				PS_Config_Lmt_FW_Diff_P = <0x4b 0x4b 0x4b 0x4b 0x4b 0x4b 0x4b 0x4b 0x4b 0x4b 0x4b 0x4b 0x4b 0x4b 0x4b 0x4b 0x4b 0x4b 0x4b 0x4b 0x4b 0x4b 0x4b 0x4b 0x4b 0x4b 0x4b 0x4b 0x4b 0x4b 0x4b 0x4b 0x4b 0x4b 0x4b 0x4b 0x4b 0x4b 0x4b 0x4b 0x4b 0x4b 0x4b 0x4b 0x4b 0x4b 0x4b 0x4b 0x4b 0x4b 0x4b 0x4b 0x4b 0x4b 0x4b 0x4b 0x4b 0x4b 0x4b 0x4b 0x4b 0x4b 0x4b 0x4b 0x4b 0x4b 0x4b 0x4b 0x4b 0x4b 0x4b 0x4b 0x4b 0x4b 0x4b 0x4b 0x4b 0x4b 0x4b 0x4b 0x4b 0x4b 0x4b 0x4b 0x4b 0x4b 0x4b 0x4b 0x4b 0x4b 0x4b 0x4b 0x4b 0x4b 0x4b 0x4b 0x4b 0x4b 0x4b 0x4b 0x4b 0x4b 0x4b 0x4b 0x4b 0x4b 0x4b 0x4b 0x4b 0x4b 0x4b 0x4b 0x4b 0x4b 0x4b 0x4b 0x4b 0x4b 0x4b 0x4b 0x4b 0x4b 0x4b 0x4b 0x4b 0x4b 0x4b 0x4b 0x4b 0x4b 0x4b 0x4b 0x4b 0x4b 0x4b 0x4b 0x4b 0x4b 0x4b 0x4b 0x4b 0x4b 0x4b 0x4b 0x4b 0x4b 0x4b 0x4b 0x4b 0x4b 0x4b 0x4b 0x4b 0x4b 0x4b 0x4b 0x4b 0x4b 0x4b 0x4b 0x4b 0x4b 0x4b 0x4b 0x4b 0x4b 0x4b 0x4b 0x4b 0x4b 0x4b 0x4b 0x4b 0x4b 0x4b 0x4b 0x4b 0x4b 0x4b 0x4b 0x4b 0x4b 0x4b 0x4b 0x4b 0x4b 0x4b 0x4b 0x4b 0x4b 0x4b 0x4b 0x4b 0x4b 0x4b 0x4b 0x4b 0x4b 0x4b 0x4b 0x4b 0x4b 0x4b 0x4b 0x4b 0x4b 0x4b 0x4b 0x4b 0x4b 0x4b 0x4b 0x4b 0x4b 0x4b 0x4b 0x4b 0x4b 0x4b 0x4b 0x4b 0x4b 0x4b 0x4b 0x4b 0x4b 0x4b 0x4b 0x4b 0x4b 0x4b 0x4b 0x4b 0x4b 0x4b 0x4b 0x4b 0x4b 0x4b 0x4b 0x4b 0x4b 0x4b 0x4b 0x4b 0x4b 0x4b 0x4b 0x4b 0x4b 0x4b 0x4b 0x4b 0x4b 0x4b 0x4b 0x4b 0x4b 0x4b 0x4b 0x4b 0x4b 0x4b 0x4b 0x4b 0x4b 0x4b 0x4b 0x4b 0x4b 0x4b 0x4b 0x4b 0x4b 0x4b 0x4b 0x4b 0x4b 0x4b 0x4b 0x4b 0x4b 0x4b 0x4b 0x4b 0x4b 0x4b 0x4b 0x4b 0x4b 0x4b 0x4b 0x4b 0x4b 0x4b 0x4b 0x4b 0x4b 0x4b 0x4b 0x4b 0x4b 0x4b 0x4b 0x4b 0x4b 0x4b 0x4b 0x4b 0x4b 0x4b 0x4b 0x4b 0x4b 0x4b 0x4b 0x4b 0x4b 0x4b 0x4b 0x4b 0x4b 0x4b 0x4b 0x4b 0x4b 0x4b 0x4b 0x4b 0x4b 0x4b 0x4b 0x4b 0x4b 0x4b 0x4b 0x4b 0x4b 0x4b 0x4b 0x4b 0x4b 0x4b 0x4b 0x4b 0x4b 0x4b 0x4b 0x4b 0x4b 0x4b 0x4b 0x4b 0x4b 0x4b 0x4b 0x4b 0x4b 0x4b 0x4b 0x4b 0x4b 0x4b 0x4b 0x4b 0x4b 0x4b 0x4b 0x4b 0x4b 0x4b 0x4b 0x4b 0x4b 0x4b 0x4b 0x4b 0x4b 0x4b 0x4b 0x4b 0x4b 0x4b 0x4b 0x4b 0x4b 0x4b 0x4b 0x4b 0x4b 0x4b 0x4b 0x4b 0x4b 0x4b 0x4b 0x4b 0x4b 0x4b 0x4b 0x4b 0x4b 0x4b 0x4b 0x4b 0x4b 0x4b 0x4b 0x4b 0x4b 0x4b 0x4b 0x4b 0x4b 0x4b 0x4b 0x4b 0x4b 0x4b 0x4b 0x4b 0x4b 0x4b 0x4b 0x4b 0x4b 0x4b 0x4b 0x4b 0x4b 0x4b 0x4b 0x4b 0x4b 0x4b 0x4b 0x4b 0x4b 0x4b 0x4b 0x4b 0x4b 0x4b 0x4b 0x4b 0x4b 0x4b 0x4b 0x4b 0x4b 0x4b 0x4b 0x4b 0x4b 0x4b 0x4b 0x4b 0x4b 0x4b 0x4b 0x4b 0x4b 0x4b 0x4b 0x4b 0x4b 0x4b 0x4b 0x4b 0x4b 0x4b 0x4b 0x4b 0x4b 0x4b 0x4b 0x4b 0x4b 0x4b 0x4b 0x4b 0x4b 0x4b 0x4b 0x4b 0x4b 0x4b 0x4b 0x4b 0x4b 0x4b 0x4b 0x4b 0x4b 0x4b 0x4b 0x4b 0x4b 0x4b 0x4b 0x4b 0x4b 0x4b 0x4b 0x4b 0x4b 0x4b 0x4b 0x4b 0x4b 0x4b 0x4b 0x4b 0x4b 0x4b 0x4b 0x4b 0x4b 0x4b 0x4b 0x4b 0x4b 0x4b 0x4b 0x4b 0x4b 0x4b 0x4b 0x4b 0x4b 0x4b 0x4b 0x4b 0x4b 0x4b 0x4b 0x4b 0x4b 0x4b 0x4b 0x4b 0x4b 0x4b 0x4b 0x4b 0x4b 0x4b 0x4b 0x4b 0x4b 0x4b 0x4b 0x4b 0x4b 0x4b 0x4b 0x4b 0x4b 0x4b 0x4b 0x4b 0x4b 0x4b 0x4b 0x4b 0x4b 0x4b 0x4b 0x4b 0x4b 0x4b 0x4b 0x4b 0x4b 0x4b 0x4b 0x4b 0x4b 0x4b 0x4b 0x4b 0x4b 0x4b 0x4b 0x4b 0x4b 0x4b 0x4b 0x4b 0x4b 0x4b 0x4b 0x4b 0x4b 0x4b 0x4b 0x4b 0x4b 0x4b 0x4b 0x4b 0x4b 0x4b 0x4b 0x4b 0x4b 0x4b 0x4b 0x4b 0x4b 0x4b 0x4b 0x4b 0x4b 0x4b 0x4b 0x4b 0x4b 0x4b 0x4b 0x4b 0x4b 0x4b 0x4b 0x4b 0x4b 0x4b 0x4b 0x4b 0x4b 0x4b 0x4b 0x4b 0x4b 0x4b 0x4b 0x4b 0x4b 0x4b 0x4b 0x4b 0x4b 0x4b 0x4b 0x4b 0x4b 0x4b 0x4b 0x4b 0x4b 0x4b>;
				PS_Config_Lmt_FW_Rawdata_N = <0xf0 0xf0 0xf0 0xf0 0xf0 0xf0 0xf0 0xf0 0xf0 0xf0 0xf0 0xf0 0xf0 0xf0 0xf0 0xf0 0xf0 0xf0 0xf0 0xf0 0xf0 0xf0 0xf0 0xf0 0xf0 0xf0 0xf0 0xf0 0xf0 0xf0 0xf0 0xf0 0xf0 0xf0 0xf0 0xf0 0xf0 0xf0 0xf0 0xf0 0xf0 0xf0 0xf0 0xf0 0xf0 0xf0 0xf0 0xf0 0xf0 0xf0 0xf0 0xf0 0xf0 0xf0 0xf0 0xf0 0xf0 0xf0 0xf0 0xf0 0xf0 0xf0 0xf0 0xf0 0xf0 0xf0 0xf0 0xf0 0xf0 0xf0 0xf0 0xf0 0xf0 0xf0 0xf0 0xf0 0xf0 0xf0 0xf0 0xf0 0xf0 0xf0 0xf0 0xf0 0xf0 0xf0 0xf0 0xf0 0xf0 0xf0 0xf0 0xf0 0xf0 0xf0 0xf0 0xf0 0xf0 0xf0 0xf0 0xf0 0xf0 0xf0 0xf0 0xf0 0xf0 0xf0 0xf0 0xf0 0xf0 0xf0 0xf0 0xf0 0xf0 0xf0 0xf0 0xf0 0xf0 0xf0 0xf0 0xf0 0xf0 0xf0 0xf0 0xf0 0xf0 0xf0 0xf0 0xf0 0xf0 0xf0 0xf0 0xf0 0xf0 0xf0 0xf0 0xf0 0xf0 0xf0 0xf0 0xf0 0xf0 0xf0 0xf0 0xf0 0xf0 0xf0 0xf0 0xf0 0xf0 0xf0 0xf0 0xf0 0xf0 0xf0 0xf0 0xf0 0xf0 0xf0 0xf0 0xf0 0xf0 0xf0 0xf0 0xf0 0xf0 0xf0 0xf0 0xf0 0xf0 0xf0 0xf0 0xf0 0xf0 0xf0 0xf0 0xf0 0xf0 0xf0 0xf0 0xf0 0xf0 0xf0 0xf0 0xf0 0xf0 0xf0 0xf0 0xf0 0xf0 0xf0 0xf0 0xf0 0xf0 0xf0 0xf0 0xf0 0xf0 0xf0 0xf0 0xf0 0xf0 0xf0 0xf0 0xf0 0xf0 0xf0 0xf0 0xf0 0xf0 0xf0 0xf0 0xf0 0xf0 0xf0 0xf0 0xf0 0xf0 0xf0 0xf0 0xf0 0xf0 0xf0 0xf0 0xf0 0xf0 0xf0 0xf0 0xf0 0xf0 0xf0 0xf0 0xf0 0xf0 0xf0 0xf0 0xf0 0xf0 0xf0 0xf0 0xf0 0xf0 0xf0 0xf0 0xf0 0xf0 0xf0 0xf0 0xf0 0xf0 0xf0 0xf0 0xf0 0xf0 0xf0 0xf0 0xf0 0xf0 0xf0 0xf0 0xf0 0xf0 0xf0 0xf0 0xf0 0xf0 0xf0 0xf0 0xf0 0xf0 0xf0 0xf0 0xf0 0xf0 0xf0 0xf0 0xf0 0xf0 0xf0 0xf0 0xf0 0xf0 0xf0 0xf0 0xf0 0xf0 0xf0 0xf0 0xf0 0xf0 0xf0 0xf0 0xf0 0xf0 0xf0 0xf0 0xf0 0xf0 0xf0 0xf0 0xf0 0xf0 0xf0 0xf0 0xf0 0xf0 0xf0 0xf0 0xf0 0xf0 0xf0 0xf0 0xf0 0xf0 0xf0 0xf0 0xf0 0xf0 0xf0 0xf0 0xf0 0xf0 0xf0 0xf0 0xf0 0xf0 0xf0 0xf0 0xf0 0xf0 0xf0 0xf0 0xf0 0xf0 0xf0 0xf0 0xf0 0xf0 0xf0 0xf0 0xf0 0xf0 0xf0 0xf0 0xf0 0xf0 0xf0 0xf0 0xf0 0xf0 0xf0 0xf0 0xf0 0xf0 0xf0 0xf0 0xf0 0xf0 0xf0 0xf0 0xf0 0xf0 0xf0 0xf0 0xf0 0xf0 0xf0 0xf0 0xf0 0xf0 0xf0 0xf0 0xf0 0xf0 0xf0 0xf0 0xf0 0xf0 0xf0 0xf0 0xf0 0xf0 0xf0 0xf0 0xf0 0xf0 0xf0 0xf0 0xf0 0xf0 0xf0 0xf0 0xf0 0xf0 0xf0 0xf0 0xf0 0xf0 0xf0 0xf0 0xf0 0xf0 0xf0 0xf0 0xf0 0xf0 0xf0 0xf0 0xf0 0xf0 0xf0 0xf0 0xf0 0xf0 0xf0 0xf0 0xf0 0xf0 0xf0 0xf0 0xf0 0xf0 0xf0 0xf0 0xf0 0xf0 0xf0 0xf0 0xf0 0xf0 0xf0 0xf0 0xf0 0xf0 0xf0 0xf0 0xf0 0xf0 0xf0 0xf0 0xf0 0xf0 0xf0 0xf0 0xf0 0xf0 0xf0 0xf0 0xf0 0xf0 0xf0 0xf0 0xf0 0xf0 0xf0 0xf0 0xf0 0xf0 0xf0 0xf0 0xf0 0xf0 0xf0 0xf0 0xf0 0xf0 0xf0 0xf0 0xf0 0xf0 0xf0 0xf0 0xf0 0xf0 0xf0 0xf0 0xf0 0xf0 0xf0 0xf0 0xf0 0xf0 0xf0 0xf0 0xf0 0xf0 0xf0 0xf0 0xf0 0xf0 0xf0 0xf0 0xf0 0xf0 0xf0 0xf0 0xf0 0xf0 0xf0 0xf0 0xf0 0xf0 0xf0 0xf0 0xf0 0xf0 0xf0 0xf0 0xf0 0xf0 0xf0 0xf0 0xf0 0xf0 0xf0 0xf0 0xf0 0xf0 0xf0 0xf0 0xf0 0xf0 0xf0 0xf0 0xf0 0xf0 0xf0 0xf0 0xf0 0xf0 0xf0 0xf0 0xf0 0xf0 0xf0 0xf0 0xf0 0xf0 0xf0 0xf0 0xf0 0xf0 0xf0 0xf0 0xf0 0xf0 0xf0 0xf0 0xf0 0xf0 0xf0 0xf0 0xf0 0xf0 0xf0 0xf0 0xf0 0xf0 0xf0 0xf0 0xf0 0xf0 0xf0 0xf0 0xf0 0xf0 0xf0 0xf0 0xf0 0xf0 0xf0 0xf0 0xf0 0xf0 0xf0 0xf0 0xf0 0xf0 0xf0 0xf0 0xf0 0xf0 0xf0 0xf0 0xf0 0xf0 0xf0 0xf0 0xf0 0xf0 0xf0 0xf0 0xf0 0xf0 0xf0 0xf0 0xf0 0xf0 0xf0 0xf0 0xf0 0xf0 0xf0 0xf0 0xf0 0xf0 0xf0 0xf0 0xf0 0xf0 0xf0 0xf0 0xf0 0xf0 0xf0 0xf0 0xf0 0xf0 0xf0 0xf0 0xf0 0xf0 0xf0 0xf0 0xf0 0xf0 0xf0 0xf0 0xf0 0xf0 0xf0 0xf0 0xf0 0xf0 0xf0 0xf0 0xf0 0xf0 0xf0 0xf0 0xf0 0xf0 0xf0 0xf0 0xf0 0xf0 0xf0 0xf0 0xf0 0xf0 0xf0 0xf0>;
				PS_Config_Lmt_FW_Rawdata_P = <0x780 0x780 0x780 0x780 0x780 0x780 0x780 0x780 0x780 0x780 0x780 0x780 0x780 0x780 0x780 0x780 0x780 0x780 0x780 0x780 0x780 0x780 0x780 0x780 0x780 0x780 0x780 0x780 0x780 0x780 0x780 0x780 0x780 0x780 0x780 0x780 0x780 0x780 0x780 0x780 0x780 0x780 0x780 0x780 0x780 0x780 0x780 0x780 0x780 0x780 0x780 0x780 0x780 0x780 0x780 0x780 0x780 0x780 0x780 0x780 0x780 0x780 0x780 0x780 0x780 0x780 0x780 0x780 0x780 0x780 0x780 0x780 0x780 0x780 0x780 0x780 0x780 0x780 0x780 0x780 0x780 0x780 0x780 0x780 0x780 0x780 0x780 0x780 0x780 0x780 0x780 0x780 0x780 0x780 0x780 0x780 0x780 0x780 0x780 0x780 0x780 0x780 0x780 0x780 0x780 0x780 0x780 0x780 0x780 0x780 0x780 0x780 0x780 0x780 0x780 0x780 0x780 0x780 0x780 0x780 0x780 0x780 0x780 0x780 0x780 0x780 0x780 0x780 0x780 0x780 0x780 0x780 0x780 0x780 0x780 0x780 0x780 0x780 0x780 0x780 0x780 0x780 0x780 0x780 0x780 0x780 0x780 0x780 0x780 0x780 0x780 0x780 0x780 0x780 0x780 0x780 0x780 0x780 0x780 0x780 0x780 0x780 0x780 0x780 0x780 0x780 0x780 0x780 0x780 0x780 0x780 0x780 0x780 0x780 0x780 0x780 0x780 0x780 0x780 0x780 0x780 0x780 0x780 0x780 0x780 0x780 0x780 0x780 0x780 0x780 0x780 0x780 0x780 0x780 0x780 0x780 0x780 0x780 0x780 0x780 0x780 0x780 0x780 0x780 0x780 0x780 0x780 0x780 0x780 0x780 0x780 0x780 0x780 0x780 0x780 0x780 0x780 0x780 0x780 0x780 0x780 0x780 0x780 0x780 0x780 0x780 0x780 0x780 0x780 0x780 0x780 0x780 0x780 0x780 0x780 0x780 0x780 0x780 0x780 0x780 0x780 0x780 0x780 0x780 0x780 0x780 0x780 0x780 0x780 0x780 0x780 0x780 0x780 0x780 0x780 0x780 0x780 0x780 0x780 0x780 0x780 0x780 0x780 0x780 0x780 0x780 0x780 0x780 0x780 0x780 0x780 0x780 0x780 0x780 0x780 0x780 0x780 0x780 0x780 0x780 0x780 0x780 0x780 0x780 0x780 0x780 0x780 0x780 0x780 0x780 0x780 0x780 0x780 0x780 0x780 0x780 0x780 0x780 0x780 0x780 0x780 0x780 0x780 0x780 0x780 0x780 0x780 0x780 0x780 0x780 0x780 0x780 0x780 0x780 0x780 0x780 0x780 0x780 0x780 0x780 0x780 0x780 0x780 0x780 0x780 0x780 0x780 0x780 0x780 0x780 0x780 0x780 0x780 0x780 0x780 0x780 0x780 0x780 0x780 0x780 0x780 0x780 0x780 0x780 0x780 0x780 0x780 0x780 0x780 0x780 0x780 0x780 0x780 0x780 0x780 0x780 0x780 0x780 0x780 0x780 0x780 0x780 0x780 0x780 0x780 0x780 0x780 0x780 0x780 0x780 0x780 0x780 0x780 0x780 0x780 0x780 0x780 0x780 0x780 0x780 0x780 0x780 0x780 0x780 0x780 0x780 0x780 0x780 0x780 0x780 0x780 0x780 0x780 0x780 0x780 0x780 0x780 0x780 0x780 0x780 0x780 0x780 0x780 0x780 0x780 0x780 0x780 0x780 0x780 0x780 0x780 0x780 0x780 0x780 0x780 0x780 0x780 0x780 0x780 0x780 0x780 0x780 0x780 0x780 0x780 0x780 0x780 0x780 0x780 0x780 0x780 0x780 0x780 0x780 0x780 0x780 0x780 0x780 0x780 0x780 0x780 0x780 0x780 0x780 0x780 0x780 0x780 0x780 0x780 0x780 0x780 0x780 0x780 0x780 0x780 0x780 0x780 0x780 0x780 0x780 0x780 0x780 0x780 0x780 0x780 0x780 0x780 0x780 0x780 0x780 0x780 0x780 0x780 0x780 0x780 0x780 0x780 0x780 0x780 0x780 0x780 0x780 0x780 0x780 0x780 0x780 0x780 0x780 0x780 0x780 0x780 0x780 0x780 0x780 0x780 0x780 0x780 0x780 0x780 0x780 0x780 0x780 0x780 0x780 0x780 0x780 0x780 0x780 0x780 0x780 0x780 0x780 0x780 0x780 0x780 0x780 0x780 0x780 0x780 0x780 0x780 0x780 0x780 0x780 0x780 0x780 0x780 0x780 0x780 0x780 0x780 0x780 0x780 0x780 0x780 0x780 0x780 0x780 0x780 0x780 0x780 0x780 0x780 0x780 0x780 0x780 0x780 0x780 0x780 0x780 0x780 0x780 0x780 0x780 0x780 0x780 0x780 0x780 0x780 0x780 0x780 0x780 0x780 0x780 0x780 0x780 0x780 0x780 0x780 0x780 0x780 0x780 0x780 0x780 0x780 0x780 0x780 0x780 0x780 0x780 0x780 0x780 0x780 0x780 0x780 0x780 0x780 0x780 0x780 0x780 0x780 0x780 0x780 0x780 0x780 0x780 0x780 0x780 0x780 0x780 0x780 0x780 0x780 0x780 0x780 0x780 0x780 0x780 0x780 0x780 0x780 0x780 0x780 0x780 0x780 0x780 0x780 0x780 0x780 0x780 0x780 0x780 0x780 0x780 0x780 0x780 0x780 0x780 0x780 0x780 0x780 0x780 0x780 0x780 0x780 0x780 0x780 0x780 0x780 0x780 0x780 0x780 0x780 0x780 0x780 0x780 0x780 0x780 0x780 0x780 0x780>;
				PS_Config_Lmt_Open_Rawdata_N = <0x32 0x32 0x32 0x32 0x32 0x32 0x32 0x32 0x32 0x32 0x32 0x32 0x32 0x32 0x32 0x32 0x32 0x32 0x32 0x32 0x32 0x32 0x32 0x32 0x32 0x32 0x32 0x32 0x32 0x32 0x32 0x32 0x32 0x32 0x32 0x32 0x32 0x32 0x32 0x32 0x32 0x32 0x32 0x32 0x32 0x32 0x32 0x32 0x32 0x32 0x32 0x32 0x32 0x32 0x32 0x32 0x32 0x32 0x32 0x32 0x32 0x32 0x32 0x32 0x32 0x32 0x32 0x32 0x32 0x32 0x32 0x32 0x32 0x32 0x32 0x32 0x32 0x32 0x32 0x32 0x32 0x32 0x32 0x32 0x32 0x32 0x32 0x32 0x32 0x32 0x32 0x32 0x32 0x32 0x32 0x32 0x32 0x32 0x32 0x32 0x32 0x32 0x32 0x32 0x32 0x32 0x32 0x32 0x32 0x32 0x32 0x32 0x32 0x32 0x32 0x32 0x32 0x32 0x32 0x32 0x32 0x32 0x32 0x32 0x32 0x32 0x32 0x32 0x32 0x32 0x32 0x32 0x32 0x32 0x32 0x32 0x32 0x32 0x32 0x32 0x32 0x32 0x32 0x32 0x32 0x32 0x32 0x32 0x32 0x32 0x32 0x32 0x32 0x32 0x32 0x32 0x32 0x32 0x32 0x32 0x32 0x32 0x32 0x32 0x32 0x32 0x32 0x32 0x32 0x32 0x32 0x32 0x32 0x32 0x32 0x32 0x32 0x32 0x32 0x32 0x32 0x32 0x32 0x32 0x32 0x32 0x32 0x32 0x32 0x32 0x32 0x32 0x32 0x32 0x32 0x32 0x32 0x32 0x32 0x32 0x32 0x32 0x32 0x32 0x32 0x32 0x32 0x32 0x32 0x32 0x32 0x32 0x32 0x32 0x32 0x32 0x32 0x32 0x32 0x32 0x32 0x32 0x32 0x32 0x32 0x32 0x32 0x32 0x32 0x32 0x32 0x32 0x32 0x32 0x32 0x32 0x32 0x32 0x32 0x32 0x32 0x32 0x32 0x32 0x32 0x32 0x32 0x32 0x32 0x32 0x32 0x32 0x32 0x32 0x32 0x32 0x32 0x32 0x32 0x32 0x32 0x32 0x32 0x32 0x32 0x32 0x32 0x32 0x32 0x32 0x32 0x32 0x32 0x32 0x32 0x32 0x32 0x32 0x32 0x32 0x32 0x32 0x32 0x32 0x32 0x32 0x32 0x32 0x32 0x32 0x32 0x32 0x32 0x32 0x32 0x32 0x32 0x32 0x32 0x32 0x32 0x32 0x32 0x32 0x32 0x32 0x32 0x32 0x32 0x32 0x32 0x32 0x32 0x32 0x32 0x32 0x32 0x32 0x32 0x32 0x32 0x32 0x32 0x32 0x32 0x32 0x32 0x32 0x32 0x32 0x32 0x32 0x32 0x32 0x32 0x32 0x32 0x32 0x32 0x32 0x32 0x32 0x32 0x32 0x32 0x32 0x32 0x32 0x32 0x32 0x32 0x32 0x32 0x32 0x32 0x32 0x32 0x32 0x32 0x32 0x32 0x32 0x32 0x32 0x32 0x32 0x32 0x32 0x32 0x32 0x32 0x32 0x32 0x32 0x32 0x32 0x32 0x32 0x32 0x32 0x32 0x32 0x32 0x32 0x32 0x32 0x32 0x32 0x32 0x32 0x32 0x32 0x32 0x32 0x32 0x32 0x32 0x32 0x32 0x32 0x32 0x32 0x32 0x32 0x32 0x32 0x32 0x32 0x32 0x32 0x32 0x32 0x32 0x32 0x32 0x32 0x32 0x32 0x32 0x32 0x32 0x32 0x32 0x32 0x32 0x32 0x32 0x32 0x32 0x32 0x32 0x32 0x32 0x32 0x32 0x32 0x32 0x32 0x32 0x32 0x32 0x32 0x32 0x32 0x32 0x32 0x32 0x32 0x32 0x32 0x32 0x32 0x32 0x32 0x32 0x32 0x32 0x32 0x32 0x32 0x32 0x32 0x32 0x32 0x32 0x32 0x32 0x32 0x32 0x32 0x32 0x32 0x32 0x32 0x32 0x32 0x32 0x32 0x32 0x32 0x32 0x32 0x32 0x32 0x32 0x32 0x32 0x32 0x32 0x32 0x32 0x32 0x32 0x32 0x32 0x32 0x32 0x32 0x32 0x32 0x32 0x32 0x32 0x32 0x32 0x32 0x32 0x32 0x32 0x32 0x32 0x32 0x32 0x32 0x32 0x32 0x32 0x32 0x32 0x32 0x32 0x32 0x32 0x32 0x32 0x32 0x32 0x32 0x32 0x32 0x32 0x32 0x32 0x32 0x32 0x32 0x32 0x32 0x32 0x32 0x32 0x32 0x32 0x32 0x32 0x32 0x32 0x32 0x32 0x32 0x32 0x32 0x32 0x32 0x32 0x32 0x32 0x32 0x32 0x32 0x32 0x32 0x32 0x32 0x32 0x32 0x32 0x32 0x32 0x32 0x32 0x32 0x32 0x32 0x32 0x32 0x32 0x32 0x32 0x32 0x32 0x32 0x32 0x32 0x32 0x32 0x32 0x32 0x32 0x32 0x32 0x32 0x32 0x32 0x32 0x32 0x32 0x32 0x32 0x32 0x32 0x32 0x32 0x32 0x32 0x32 0x32 0x32 0x32 0x32 0x32 0x32 0x32 0x32 0x32 0x32 0x32 0x32 0x32 0x32 0x32 0x32 0x32 0x32 0x32 0x32 0x32 0x32 0x32 0x32 0x32 0x32 0x32 0x32 0x32 0x32 0x32 0x32 0x32 0x32 0x32 0x32 0x32 0x32 0x32 0x32 0x32 0x32 0x32 0x32 0x32>;
				PS_Config_Lmt_Open_Rawdata_P = <0x1000 0x1000 0x1000 0x1000 0x1000 0x1000 0x1000 0x1000 0x1000 0x1000 0x1000 0x1000 0x1000 0x1000 0x1000 0x1000 0x1000 0x1000 0x1000 0x1000 0x1000 0x1000 0x1000 0x1000 0x1000 0x1000 0x1000 0x1000 0x1000 0x1000 0x1000 0x1000 0x1000 0x1000 0x1000 0x1000 0x1000 0x1000 0x1000 0x1000 0x1000 0x1000 0x1000 0x1000 0x1000 0x1000 0x1000 0x1000 0x1000 0x1000 0x1000 0x1000 0x1000 0x1000 0x1000 0x1000 0x1000 0x1000 0x1000 0x1000 0x1000 0x1000 0x1000 0x1000 0x1000 0x1000 0x1000 0x1000 0x1000 0x1000 0x1000 0x1000 0x1000 0x1000 0x1000 0x1000 0x1000 0x1000 0x1000 0x1000 0x1000 0x1000 0x1000 0x1000 0x1000 0x1000 0x1000 0x1000 0x1000 0x1000 0x1000 0x1000 0x1000 0x1000 0x1000 0x1000 0x1000 0x1000 0x1000 0x1000 0x1000 0x1000 0x1000 0x1000 0x1000 0x1000 0x1000 0x1000 0x1000 0x1000 0x1000 0x1000 0x1000 0x1000 0x1000 0x1000 0x1000 0x1000 0x1000 0x1000 0x1000 0x1000 0x1000 0x1000 0x1000 0x1000 0x1000 0x1000 0x1000 0x1000 0x1000 0x1000 0x1000 0x1000 0x1000 0x1000 0x1000 0x1000 0x1000 0x1000 0x1000 0x1000 0x1000 0x1000 0x1000 0x1000 0x1000 0x1000 0x1000 0x1000 0x1000 0x1000 0x1000 0x1000 0x1000 0x1000 0x1000 0x1000 0x1000 0x1000 0x1000 0x1000 0x1000 0x1000 0x1000 0x1000 0x1000 0x1000 0x1000 0x1000 0x1000 0x1000 0x1000 0x1000 0x1000 0x1000 0x1000 0x1000 0x1000 0x1000 0x1000 0x1000 0x1000 0x1000 0x1000 0x1000 0x1000 0x1000 0x1000 0x1000 0x1000 0x1000 0x1000 0x1000 0x1000 0x1000 0x1000 0x1000 0x1000 0x1000 0x1000 0x1000 0x1000 0x1000 0x1000 0x1000 0x1000 0x1000 0x1000 0x1000 0x1000 0x1000 0x1000 0x1000 0x1000 0x1000 0x1000 0x1000 0x1000 0x1000 0x1000 0x1000 0x1000 0x1000 0x1000 0x1000 0x1000 0x1000 0x1000 0x1000 0x1000 0x1000 0x1000 0x1000 0x1000 0x1000 0x1000 0x1000 0x1000 0x1000 0x1000 0x1000 0x1000 0x1000 0x1000 0x1000 0x1000 0x1000 0x1000 0x1000 0x1000 0x1000 0x1000 0x1000 0x1000 0x1000 0x1000 0x1000 0x1000 0x1000 0x1000 0x1000 0x1000 0x1000 0x1000 0x1000 0x1000 0x1000 0x1000 0x1000 0x1000 0x1000 0x1000 0x1000 0x1000 0x1000 0x1000 0x1000 0x1000 0x1000 0x1000 0x1000 0x1000 0x1000 0x1000 0x1000 0x1000 0x1000 0x1000 0x1000 0x1000 0x1000 0x1000 0x1000 0x1000 0x1000 0x1000 0x1000 0x1000 0x1000 0x1000 0x1000 0x1000 0x1000 0x1000 0x1000 0x1000 0x1000 0x1000 0x1000 0x1000 0x1000 0x1000 0x1000 0x1000 0x1000 0x1000 0x1000 0x1000 0x1000 0x1000 0x1000 0x1000 0x1000 0x1000 0x1000 0x1000 0x1000 0x1000 0x1000 0x1000 0x1000 0x1000 0x1000 0x1000 0x1000 0x1000 0x1000 0x1000 0x1000 0x1000 0x1000 0x1000 0x1000 0x1000 0x1000 0x1000 0x1000 0x1000 0x1000 0x1000 0x1000 0x1000 0x1000 0x1000 0x1000 0x1000 0x1000 0x1000 0x1000 0x1000 0x1000 0x1000 0x1000 0x1000 0x1000 0x1000 0x1000 0x1000 0x1000 0x1000 0x1000 0x1000 0x1000 0x1000 0x1000 0x1000 0x1000 0x1000 0x1000 0x1000 0x1000 0x1000 0x1000 0x1000 0x1000 0x1000 0x1000 0x1000 0x1000 0x1000 0x1000 0x1000 0x1000 0x1000 0x1000 0x1000 0x1000 0x1000 0x1000 0x1000 0x1000 0x1000 0x1000 0x1000 0x1000 0x1000 0x1000 0x1000 0x1000 0x1000 0x1000 0x1000 0x1000 0x1000 0x1000 0x1000 0x1000 0x1000 0x1000 0x1000 0x1000 0x1000 0x1000 0x1000 0x1000 0x1000 0x1000 0x1000 0x1000 0x1000 0x1000 0x1000 0x1000 0x1000 0x1000 0x1000 0x1000 0x1000 0x1000 0x1000 0x1000 0x1000 0x1000 0x1000 0x1000 0x1000 0x1000 0x1000 0x1000 0x1000 0x1000 0x1000 0x1000 0x1000 0x1000 0x1000 0x1000 0x1000 0x1000 0x1000 0x1000 0x1000 0x1000 0x1000 0x1000 0x1000 0x1000 0x1000 0x1000 0x1000 0x1000 0x1000 0x1000 0x1000 0x1000 0x1000 0x1000 0x1000 0x1000 0x1000 0x1000 0x1000 0x1000 0x1000 0x1000 0x1000 0x1000 0x1000 0x1000 0x1000 0x1000 0x1000 0x1000 0x1000 0x1000 0x1000 0x1000 0x1000 0x1000 0x1000 0x1000 0x1000 0x1000 0x1000 0x1000 0x1000 0x1000 0x1000 0x1000 0x1000 0x1000 0x1000 0x1000 0x1000 0x1000 0x1000 0x1000 0x1000 0x1000 0x1000 0x1000 0x1000 0x1000 0x1000 0x1000 0x1000 0x1000 0x1000 0x1000 0x1000 0x1000 0x1000 0x1000 0x1000 0x1000 0x1000 0x1000 0x1000 0x1000 0x1000 0x1000 0x1000 0x1000 0x1000 0x1000 0x1000 0x1000 0x1000 0x1000 0x1000 0x1000 0x1000 0x1000 0x1000 0x1000 0x1000 0x1000 0x1000 0x1000 0x1000 0x1000 0x1000 0x1000 0x1000 0x1000 0x1000 0x1000 0x1000 0x1000 0x1000 0x1000 0x1000 0x1000 0x1000 0x1000 0x1000 0x1000 0x1000 0x1000 0x1000 0x1000 0x1000 0x1000 0x1000 0x1000 0x1000 0x1000 0x1000 0x1000 0x1000 0x1000 0x1000 0x1000 0x1000 0x1000 0x1000 0x1000 0x1000 0x1000 0x1000 0x1000 0x1000 0x1000 0x1000 0x1000 0x1000 0x1000 0x1000 0x1000 0x1000 0x1000 0x1000 0x1000 0x1000 0x1000 0x1000 0x1000 0x1000 0x1000 0x1000 0x1000 0x1000 0x1000 0x1000 0x1000 0x1000 0x1000 0x1000 0x1000 0x1000 0x1000 0x1000 0x1000 0x1000 0x1000 0x1000 0x1000 0x1000 0x1000 0x1000 0x1000 0x1000 0x1000 0x1000 0x1000 0x1000 0x1000 0x1000 0x1000 0x1000>;
				PS_Config_Lmt_Short_Rawdata_N = <0x2710 0x2710 0x2710 0x2710 0x2710 0x2710 0x2710 0x2710 0x2710 0x2710 0x2710 0x2710 0x2710 0x2710 0x2710 0x2710 0x2710 0x2710 0x2710 0x2710 0x2710 0x2710 0x2710 0x2710 0x2710 0x2710 0x2710 0x2710 0x2710 0x2710 0x2710 0x2710 0x2710 0x2710 0x2710 0x2710 0x2710 0x2710 0x2710 0x2710 0x2710 0x2710 0x2710 0x2710 0x2710 0x2710 0x2710 0x2710 0x2710 0x2710 0x2710 0x2710 0x2710 0x2710 0x2710 0x2710 0x2710 0x2710 0x2710 0x2710 0x2710 0x2710 0x2710 0x2710 0x2710 0x2710 0x2710 0x2710 0x2710 0x2710 0x2710 0x2710 0x2710 0x2710 0x2710 0x2710 0x2710 0x2710 0x2710 0x2710 0x2710 0x2710 0x2710 0x2710 0x2710 0x2710 0x2710 0x2710 0x2710 0x2710 0x2710 0x2710 0x2710 0x2710 0x2710 0x2710 0x2710 0x2710 0x2710 0x2710 0x2710 0x2710 0x2710 0x2710 0x2710 0x2710 0x2710 0x2710 0x2710 0x2710 0x2710 0x2710 0x2710 0x2710 0x2710 0x2710 0x2710 0x2710 0x2710 0x2710 0x2710 0x2710 0x2710 0x2710 0x2710 0x2710 0x2710 0x2710 0x2710 0x2710 0x2710 0x2710 0x2710 0x2710 0x2710 0x2710 0x2710 0x2710 0x2710 0x2710 0x2710 0x2710 0x2710 0x2710 0x2710 0x2710 0x2710 0x2710 0x2710 0x2710 0x2710 0x2710 0x2710 0x2710 0x2710 0x2710 0x2710 0x2710 0x2710 0x2710 0x2710 0x2710 0x2710 0x2710 0x2710 0x2710 0x2710 0x2710 0x2710 0x2710 0x2710 0x2710 0x2710 0x2710 0x2710 0x2710 0x2710 0x2710 0x2710 0x2710 0x2710 0x2710 0x2710 0x2710 0x2710 0x2710 0x2710 0x2710 0x2710 0x2710 0x2710 0x2710 0x2710 0x2710 0x2710 0x2710 0x2710 0x2710 0x2710 0x2710 0x2710 0x2710 0x2710 0x2710 0x2710 0x2710 0x2710 0x2710 0x2710 0x2710 0x2710 0x2710 0x2710 0x2710 0x2710 0x2710 0x2710 0x2710 0x2710 0x2710 0x2710 0x2710 0x2710 0x2710 0x2710 0x2710 0x2710 0x2710 0x2710 0x2710 0x2710 0x2710 0x2710 0x2710 0x2710 0x2710 0x2710 0x2710 0x2710 0x2710 0x2710 0x2710 0x2710 0x2710 0x2710 0x2710 0x2710 0x2710 0x2710 0x2710 0x2710 0x2710 0x2710 0x2710 0x2710 0x2710 0x2710 0x2710 0x2710 0x2710 0x2710 0x2710 0x2710 0x2710 0x2710 0x2710 0x2710 0x2710 0x2710 0x2710 0x2710 0x2710 0x2710 0x2710 0x2710 0x2710 0x2710 0x2710 0x2710 0x2710 0x2710 0x2710 0x2710 0x2710 0x2710 0x2710 0x2710 0x2710 0x2710 0x2710 0x2710 0x2710 0x2710 0x2710 0x2710 0x2710 0x2710 0x2710 0x2710 0x2710 0x2710 0x2710 0x2710 0x2710 0x2710 0x2710 0x2710 0x2710 0x2710 0x2710 0x2710 0x2710 0x2710 0x2710 0x2710 0x2710 0x2710 0x2710 0x2710 0x2710 0x2710 0x2710 0x2710 0x2710 0x2710 0x2710 0x2710 0x2710 0x2710 0x2710 0x2710 0x2710 0x2710 0x2710 0x2710 0x2710 0x2710 0x2710 0x2710 0x2710 0x2710 0x2710 0x2710 0x2710 0x2710 0x2710 0x2710 0x2710 0x2710 0x2710 0x2710 0x2710 0x2710 0x2710 0x2710 0x2710 0x2710 0x2710 0x2710 0x2710 0x2710 0x2710 0x2710 0x2710 0x2710 0x2710 0x2710 0x2710 0x2710 0x2710 0x2710 0x2710 0x2710 0x2710 0x2710 0x2710 0x2710 0x2710 0x2710 0x2710 0x2710 0x2710 0x2710 0x2710 0x2710 0x2710 0x2710 0x2710 0x2710 0x2710 0x2710 0x2710 0x2710 0x2710 0x2710 0x2710 0x2710 0x2710 0x2710 0x2710 0x2710 0x2710 0x2710 0x2710 0x2710 0x2710 0x2710 0x2710 0x2710 0x2710 0x2710 0x2710 0x2710 0x2710 0x2710 0x2710 0x2710 0x2710 0x2710 0x2710 0x2710 0x2710 0x2710 0x2710 0x2710 0x2710 0x2710 0x2710 0x2710 0x2710 0x2710 0x2710 0x2710 0x2710 0x2710 0x2710 0x2710 0x2710 0x2710 0x2710 0x2710 0x2710 0x2710 0x2710 0x2710 0x2710 0x2710 0x2710 0x2710 0x2710 0x2710 0x2710 0x2710 0x2710 0x2710 0x2710 0x2710 0x2710 0x2710 0x2710 0x2710 0x2710 0x2710 0x2710 0x2710 0x2710 0x2710 0x2710 0x2710 0x2710 0x2710 0x2710 0x2710 0x2710 0x2710 0x2710 0x2710 0x2710 0x2710 0x2710 0x2710 0x2710 0x2710 0x2710 0x2710 0x2710 0x2710 0x2710 0x2710 0x2710 0x2710 0x2710 0x2710 0x2710 0x2710 0x2710 0x2710 0x2710 0x2710 0x2710 0x2710 0x2710 0x2710 0x2710 0x2710 0x2710 0x2710 0x2710 0x2710 0x2710 0x2710 0x2710 0x2710 0x2710 0x2710 0x2710 0x2710 0x2710 0x2710 0x2710 0x2710 0x2710 0x2710 0x2710 0x2710 0x2710 0x2710 0x2710 0x2710 0x2710 0x2710 0x2710 0x2710 0x2710 0x2710 0x2710 0x2710 0x2710 0x2710 0x2710 0x2710 0x2710 0x2710 0x2710 0x2710 0x2710 0x2710 0x2710 0x2710 0x2710 0x2710 0x2710 0x2710 0x2710 0x2710 0x2710 0x2710 0x2710 0x2710 0x2710 0x2710 0x2710 0x2710 0x2710 0x2710 0x2710 0x2710 0x2710 0x2710 0x2710 0x2710 0x2710 0x2710 0x2710 0x2710 0x2710 0x2710 0x2710 0x2710 0x2710 0x2710 0x2710 0x2710 0x2710 0x2710 0x2710 0x2710 0x2710 0x2710 0x2710 0x2710 0x2710 0x2710 0x2710 0x2710 0x2710 0x2710 0x2710 0x2710 0x2710 0x2710 0x2710 0x2710 0x2710 0x2710 0x2710 0x2710 0x2710 0x2710 0x2710 0x2710 0x2710 0x2710 0x2710 0x2710 0x2710 0x2710 0x2710 0x2710 0x2710 0x2710 0x2710 0x2710 0x2710 0x2710 0x2710 0x2710 0x2710 0x2710 0x2710 0x2710 0x2710 0x2710 0x2710 0x2710 0x2710 0x2710 0x2710 0x2710 0x2710 0x2710 0x2710 0x2710 0x2710 0x2710 0x2710 0x2710 0x2710 0x2710 0x2710 0x2710>;
				PS_Config_Lmt_Short_Rawdata_P = <0x36b8 0x36b8 0x36b8 0x36b8 0x36b8 0x36b8 0x36b8 0x36b8 0x36b8 0x36b8 0x36b8 0x36b8 0x36b8 0x36b8 0x36b8 0x36b8 0x36b8 0x36b8 0x36b8 0x36b8 0x36b8 0x36b8 0x36b8 0x36b8 0x36b8 0x36b8 0x36b8 0x36b8 0x36b8 0x36b8 0x36b8 0x36b8 0x36b8 0x36b8 0x36b8 0x36b8 0x36b8 0x36b8 0x36b8 0x36b8 0x36b8 0x36b8 0x36b8 0x36b8 0x36b8 0x36b8 0x36b8 0x36b8 0x36b8 0x36b8 0x36b8 0x36b8 0x36b8 0x36b8 0x36b8 0x36b8 0x36b8 0x36b8 0x36b8 0x36b8 0x36b8 0x36b8 0x36b8 0x36b8 0x36b8 0x36b8 0x36b8 0x36b8 0x36b8 0x36b8 0x36b8 0x36b8 0x36b8 0x36b8 0x36b8 0x36b8 0x36b8 0x36b8 0x36b8 0x36b8 0x36b8 0x36b8 0x36b8 0x36b8 0x36b8 0x36b8 0x36b8 0x36b8 0x36b8 0x36b8 0x36b8 0x36b8 0x36b8 0x36b8 0x36b8 0x36b8 0x36b8 0x36b8 0x36b8 0x36b8 0x36b8 0x36b8 0x36b8 0x36b8 0x36b8 0x36b8 0x36b8 0x36b8 0x36b8 0x36b8 0x36b8 0x36b8 0x36b8 0x36b8 0x36b8 0x36b8 0x36b8 0x36b8 0x36b8 0x36b8 0x36b8 0x36b8 0x36b8 0x36b8 0x36b8 0x36b8 0x36b8 0x36b8 0x36b8 0x36b8 0x36b8 0x36b8 0x36b8 0x36b8 0x36b8 0x36b8 0x36b8 0x36b8 0x36b8 0x36b8 0x36b8 0x36b8 0x36b8 0x36b8 0x36b8 0x36b8 0x36b8 0x36b8 0x36b8 0x36b8 0x36b8 0x36b8 0x36b8 0x36b8 0x36b8 0x36b8 0x36b8 0x36b8 0x36b8 0x36b8 0x36b8 0x36b8 0x36b8 0x36b8 0x36b8 0x36b8 0x36b8 0x36b8 0x36b8 0x36b8 0x36b8 0x36b8 0x36b8 0x36b8 0x36b8 0x36b8 0x36b8 0x36b8 0x36b8 0x36b8 0x36b8 0x36b8 0x36b8 0x36b8 0x36b8 0x36b8 0x36b8 0x36b8 0x36b8 0x36b8 0x36b8 0x36b8 0x36b8 0x36b8 0x36b8 0x36b8 0x36b8 0x36b8 0x36b8 0x36b8 0x36b8 0x36b8 0x36b8 0x36b8 0x36b8 0x36b8 0x36b8 0x36b8 0x36b8 0x36b8 0x36b8 0x36b8 0x36b8 0x36b8 0x36b8 0x36b8 0x36b8 0x36b8 0x36b8 0x36b8 0x36b8 0x36b8 0x36b8 0x36b8 0x36b8 0x36b8 0x36b8 0x36b8 0x36b8 0x36b8 0x36b8 0x36b8 0x36b8 0x36b8 0x36b8 0x36b8 0x36b8 0x36b8 0x36b8 0x36b8 0x36b8 0x36b8 0x36b8 0x36b8 0x36b8 0x36b8 0x36b8 0x36b8 0x36b8 0x36b8 0x36b8 0x36b8 0x36b8 0x36b8 0x36b8 0x36b8 0x36b8 0x36b8 0x36b8 0x36b8 0x36b8 0x36b8 0x36b8 0x36b8 0x36b8 0x36b8 0x36b8 0x36b8 0x36b8 0x36b8 0x36b8 0x36b8 0x36b8 0x36b8 0x36b8 0x36b8 0x36b8 0x36b8 0x36b8 0x36b8 0x36b8 0x36b8 0x36b8 0x36b8 0x36b8 0x36b8 0x36b8 0x36b8 0x36b8 0x36b8 0x36b8 0x36b8 0x36b8 0x36b8 0x36b8 0x36b8 0x36b8 0x36b8 0x36b8 0x36b8 0x36b8 0x36b8 0x36b8 0x36b8 0x36b8 0x36b8 0x36b8 0x36b8 0x36b8 0x36b8 0x36b8 0x36b8 0x36b8 0x36b8 0x36b8 0x36b8 0x36b8 0x36b8 0x36b8 0x36b8 0x36b8 0x36b8 0x36b8 0x36b8 0x36b8 0x36b8 0x36b8 0x36b8 0x36b8 0x36b8 0x36b8 0x36b8 0x36b8 0x36b8 0x36b8 0x36b8 0x36b8 0x36b8 0x36b8 0x36b8 0x36b8 0x36b8 0x36b8 0x36b8 0x36b8 0x36b8 0x36b8 0x36b8 0x36b8 0x36b8 0x36b8 0x36b8 0x36b8 0x36b8 0x36b8 0x36b8 0x36b8 0x36b8 0x36b8 0x36b8 0x36b8 0x36b8 0x36b8 0x36b8 0x36b8 0x36b8 0x36b8 0x36b8 0x36b8 0x36b8 0x36b8 0x36b8 0x36b8 0x36b8 0x36b8 0x36b8 0x36b8 0x36b8 0x36b8 0x36b8 0x36b8 0x36b8 0x36b8 0x36b8 0x36b8 0x36b8 0x36b8 0x36b8 0x36b8 0x36b8 0x36b8 0x36b8 0x36b8 0x36b8 0x36b8 0x36b8 0x36b8 0x36b8 0x36b8 0x36b8 0x36b8 0x36b8 0x36b8 0x36b8 0x36b8 0x36b8 0x36b8 0x36b8 0x36b8 0x36b8 0x36b8 0x36b8 0x36b8 0x36b8 0x36b8 0x36b8 0x36b8 0x36b8 0x36b8 0x36b8 0x36b8 0x36b8 0x36b8 0x36b8 0x36b8 0x36b8 0x36b8 0x36b8 0x36b8 0x36b8 0x36b8 0x36b8 0x36b8 0x36b8 0x36b8 0x36b8 0x36b8 0x36b8 0x36b8 0x36b8 0x36b8 0x36b8 0x36b8 0x36b8 0x36b8 0x36b8 0x36b8 0x36b8 0x36b8 0x36b8 0x36b8 0x36b8 0x36b8 0x36b8 0x36b8 0x36b8 0x36b8 0x36b8 0x36b8 0x36b8 0x36b8 0x36b8 0x36b8 0x36b8 0x36b8 0x36b8 0x36b8 0x36b8 0x36b8 0x36b8 0x36b8 0x36b8 0x36b8 0x36b8 0x36b8 0x36b8 0x36b8 0x36b8 0x36b8 0x36b8 0x36b8 0x36b8 0x36b8 0x36b8 0x36b8 0x36b8 0x36b8 0x36b8 0x36b8 0x36b8 0x36b8 0x36b8 0x36b8 0x36b8 0x36b8 0x36b8 0x36b8 0x36b8 0x36b8 0x36b8 0x36b8 0x36b8 0x36b8 0x36b8 0x36b8 0x36b8 0x36b8 0x36b8 0x36b8 0x36b8 0x36b8 0x36b8 0x36b8 0x36b8 0x36b8 0x36b8 0x36b8 0x36b8 0x36b8 0x36b8 0x36b8 0x36b8 0x36b8 0x36b8 0x36b8 0x36b8 0x36b8 0x36b8 0x36b8 0x36b8 0x36b8 0x36b8 0x36b8 0x36b8 0x36b8 0x36b8 0x36b8 0x36b8 0x36b8 0x36b8 0x36b8 0x36b8 0x36b8 0x36b8 0x36b8 0x36b8 0x36b8 0x36b8 0x36b8 0x36b8 0x36b8 0x36b8 0x36b8 0x36b8 0x36b8 0x36b8 0x36b8 0x36b8 0x36b8 0x36b8 0x36b8 0x36b8 0x36b8 0x36b8 0x36b8 0x36b8 0x36b8 0x36b8 0x36b8 0x36b8 0x36b8 0x36b8 0x36b8 0x36b8 0x36b8 0x36b8 0x36b8 0x36b8 0x36b8 0x36b8 0x36b8 0x36b8 0x36b8 0x36b8 0x36b8 0x36b8 0x36b8 0x36b8 0x36b8 0x36b8 0x36b8 0x36b8 0x36b8 0x36b8 0x36b8 0x36b8 0x36b8 0x36b8 0x36b8 0x36b8 0x36b8 0x36b8 0x36b8 0x36b8 0x36b8 0x36b8 0x36b8 0x36b8 0x36b8 0x36b8 0x36b8 0x36b8 0x36b8 0x36b8 0x36b8 0x36b8 0x36b8 0x36b8 0x36b8 0x36b8 0x36b8 0x36b8 0x36b8 0x36b8 0x36b8 0x36b8 0x36b8 0x36b8 0x36b8 0x36b8 0x36b8 0x36b8 0x36b8 0x36b8 0x36b8 0x36b8 0x36b8 0x36b8 0x36b8 0x36b8 0x36b8 0x36b8 0x36b8 0x36b8 0x36b8 0x36b8 0x36b8 0x36b8 0x36b8 0x36b8 0x36b8>;
				X_Channel = <0x12>;
				Y_Channel = <0x24>;
				compatible = "novatek-mp-criteria-nvtpid";
			};
		};
	};

	fragment@51 {
		target = <0xffffffff>;

		__overlay__ {
			regulator-default-on = <0x1>;
			status = "okay";
		};
	};

	fragment@52 {
		target = <0xffffffff>;

		__overlay__ {

			camdefault {
				phandle = <0x31>;
			};

			camera0_mclk_2ma@gpio116 {
				phandle = <0x5b>;

				pins_cmd_dat {
					drive-strength = <0x0>;
					pinmux = <0x7401>;
				};
			};

			camera0_mclk_4ma@gpio116 {
				phandle = <0x5c>;

				pins_cmd_dat {
					drive-strength = <0x1>;
					pinmux = <0x7401>;
				};
			};

			camera0_mclk_6ma@gpio116 {
				phandle = <0x5d>;

				pins_cmd_dat {
					drive-strength = <0x2>;
					pinmux = <0x7401>;
				};
			};

			camera0_mclk_8ma@gpio116 {
				phandle = <0x5e>;

				pins_cmd_dat {
					drive-strength = <0x3>;
					pinmux = <0x7401>;
				};
			};

			camera0_mclk_gpio_mode@gpio116 {
				phandle = <0x5a>;

				pins_cmd_dat {
					drive-strength = <0x1>;
					pinmux = <0x7400>;
				};
			};

			camera0_pdn_output_high@gpio93 {
				phandle = <0x35>;

				pins_cmd_dat {
					output-high;
					pinmux = <0x5d00>;
				};
			};

			camera0_pdn_output_low@gpio93 {
				phandle = <0x34>;

				pins_cmd_dat {
					output-low;
					pinmux = <0x5d00>;
				};
			};

			camera0_rst_output_high@gpio118 {
				phandle = <0x33>;

				pins_cmd_dat {
					output-high;
					pinmux = <0x7600>;
				};
			};

			camera0_rst_output_low@gpio118 {
				phandle = <0x32>;

				pins_cmd_dat {
					output-low;
					pinmux = <0x7600>;
				};
			};

			camera0_vcama_output_high@gpio114 {
				phandle = <0x47>;

				pins_cmd_dat {
					output-high;
					pinmux = <0x7200>;
				};
			};

			camera0_vcama_output_low@gpio114 {
				phandle = <0x46>;

				pins_cmd_dat {
					output-low;
					pinmux = <0x7200>;
				};
			};

			camera0_vcamd_output_high@gpio114 {
				phandle = <0x49>;

				pins_cmd_dat {
					output-high;
					pinmux = <0x7200>;
				};
			};

			camera0_vcamd_output_low@gpio114 {
				phandle = <0x48>;

				pins_cmd_dat {
					output-low;
					pinmux = <0x7200>;
					slew-rate = <0x1>;
				};
			};

			camera1_mclk_2ma@gpio120 {
				phandle = <0x60>;

				pins_cmd_dat {
					drive-strength = <0x0>;
					pinmux = <0x7801>;
				};
			};

			camera1_mclk_4ma@gpio120 {
				phandle = <0x61>;

				pins_cmd_dat {
					drive-strength = <0x1>;
					pinmux = <0x7801>;
				};
			};

			camera1_mclk_6ma@gpio120 {
				phandle = <0x62>;

				pins_cmd_dat {
					drive-strength = <0x2>;
					pinmux = <0x7801>;
				};
			};

			camera1_mclk_8ma@gpio120 {
				phandle = <0x63>;

				pins_cmd_dat {
					drive-strength = <0x3>;
					pinmux = <0x7801>;
				};
			};

			camera1_mclk_gpio_mode@gpio120 {
				phandle = <0x5f>;

				pins_cmd_dat {
					drive-strength = <0x1>;
					pinmux = <0x7800>;
				};
			};

			camera1_pdn_output_high@gpio122 {
				phandle = <0x39>;

				pins_cmd_dat {
					output-high;
					pinmux = <0x7a00>;
				};
			};

			camera1_pdn_output_low@gpio122 {
				phandle = <0x38>;

				pins_cmd_dat {
					output-low;
					pinmux = <0x7a00>;
				};
			};

			camera1_rst_output_high@gpio124 {
				phandle = <0x37>;

				pins_cmd_dat {
					output-high;
					pinmux = <0x7c00>;
				};
			};

			camera1_rst_output_low@gpio124 {
				phandle = <0x36>;

				pins_cmd_dat {
					output-low;
					pinmux = <0x7c00>;
				};
			};

			camera1_vcama_output_hgigh@gpio123 {
				phandle = <0x4b>;

				pins_cmd_dat {
					output-high;
					pinmux = <0x7b00>;
				};
			};

			camera1_vcama_output_low@gpio123 {
				phandle = <0x4a>;

				pins_cmd_dat {
					output-low;
					pinmux = <0x7b00>;
				};
			};

			camera1_vcamd_output_high@gpio122 {
				phandle = <0x4d>;

				pins_cmd_dat {
					output-high;
					pinmux = <0x7a00>;
				};
			};

			camera1_vcamd_output_low@gpio122 {
				phandle = <0x4c>;

				pins_cmd_dat {
					output-low;
					pinmux = <0x7a00>;
					slew-rate = <0x1>;
				};
			};

			camera2_mclk_2ma@gpio121 {
				phandle = <0x65>;

				pins_cmd_dat {
					drive-strength = <0x0>;
					pinmux = <0x7901>;
				};
			};

			camera2_mclk_4ma@gpio121 {
				phandle = <0x66>;

				pins_cmd_dat {
					drive-strength = <0x1>;
					pinmux = <0x7901>;
				};
			};

			camera2_mclk_6ma@gpio121 {
				phandle = <0x67>;

				pins_cmd_dat {
					drive-strength = <0x2>;
					pinmux = <0x7901>;
				};
			};

			camera2_mclk_8ma@gpio121 {
				phandle = <0x68>;

				pins_cmd_dat {
					drive-strength = <0x3>;
					pinmux = <0x7901>;
				};
			};

			camera2_mclk_gpio_mode@gpio121 {
				phandle = <0x64>;

				pins_cmd_dat {
					drive-strength = <0x1>;
					pinmux = <0x7900>;
				};
			};

			camera2_pdn_output_high@gpio123 {
				phandle = <0x3d>;

				pins_cmd_dat {
					output-high;
					pinmux = <0x7b00>;
				};
			};

			camera2_pdn_output_low@gpio123 {
				phandle = <0x3c>;

				pins_cmd_dat {
					output-low;
					pinmux = <0x7b00>;
				};
			};

			camera2_rst_output_high@gpio125 {
				phandle = <0x3b>;

				pins_cmd_dat {
					output-high;
					pinmux = <0x7d00>;
				};
			};

			camera2_rst_output_low@gpio125 {
				phandle = <0x3a>;

				pins_cmd_dat {
					output-low;
					pinmux = <0x7d00>;
				};
			};

			camera2_vcama_output_high@gpio123 {
				phandle = <0x4f>;

				pins_cmd_dat {
					output-high;
					pinmux = <0x7b00>;
				};
			};

			camera2_vcama_output_low@gpio123 {
				phandle = <0x4e>;

				pins_cmd_dat {
					output-low;
					pinmux = <0x7b00>;
				};
			};

			camera2_vcamd_output_high@gpio123 {
				phandle = <0x51>;

				pins_cmd_dat {
					output-high;
					pinmux = <0x7b00>;
				};
			};

			camera2_vcamd_output_low@gpio123 {
				phandle = <0x50>;

				pins_cmd_dat {
					output-low;
					pinmux = <0x7b00>;
				};
			};

			camera3_mclk_2ma@gpio117 {
				phandle = <0x6a>;

				pins_cmd_dat {
					drive-strength = <0x0>;
					pinmux = <0x7501>;
				};
			};

			camera3_mclk_4ma@gpio117 {
				phandle = <0x6b>;

				pins_cmd_dat {
					drive-strength = <0x1>;
					pinmux = <0x7501>;
				};
			};

			camera3_mclk_6ma@gpio117 {
				phandle = <0x6c>;

				pins_cmd_dat {
					drive-strength = <0x2>;
					pinmux = <0x7501>;
				};
			};

			camera3_mclk_8ma@gpio117 {
				phandle = <0x6d>;

				pins_cmd_dat {
					drive-strength = <0x3>;
					pinmux = <0x7501>;
				};
			};

			camera3_mclk_gpio_mode@gpio117 {
				phandle = <0x69>;

				pins_cmd_dat {
					drive-strength = <0x1>;
					pinmux = <0x7500>;
				};
			};

			camera3_pdn_output_high@gpio115 {
				phandle = <0x41>;

				pins_cmd_dat {
					output-high;
					pinmux = <0x7300>;
				};
			};

			camera3_pdn_output_low@gpio115 {
				phandle = <0x40>;

				pins_cmd_dat {
					output-low;
					pinmux = <0x7300>;
				};
			};

			camera3_rst_output_high@gpio119 {
				phandle = <0x3f>;

				pins_cmd_dat {
					output-high;
					pinmux = <0x7700>;
				};
			};

			camera3_rst_output_low@gpio119 {
				phandle = <0x3e>;

				pins_cmd_dat {
					output-low;
					pinmux = <0x7700>;
				};
			};

			camera3_vcama_output_high@gpio195 {
				phandle = <0x53>;

				pins_cmd_dat {
					output-high;
					pinmux = <0xc300>;
				};
			};

			camera3_vcama_output_low@gpio195 {
				phandle = <0x52>;

				pins_cmd_dat {
					output-low;
					pinmux = <0xc300>;
				};
			};

			camera3_vcamd_output_high@gpio195 {
				phandle = <0x55>;

				pins_cmd_dat {
					output-high;
					pinmux = <0xc300>;
				};
			};

			camera3_vcamd_output_low@gpio195 {
				phandle = <0x54>;

				pins_cmd_dat {
					output-low;
					pinmux = <0xc300>;
					slew-rate = <0x1>;
				};
			};

			camera4_mclk_2ma@gpio196 {
				phandle = <0x6f>;

				pins_cmd_dat {
					drive-strength = <0x0>;
					pinmux = <0xc401>;
				};
			};

			camera4_mclk_4ma@gpio196 {
				phandle = <0x70>;

				pins_cmd_dat {
					drive-strength = <0x1>;
					pinmux = <0xc401>;
				};
			};

			camera4_mclk_6ma@gpio196 {
				phandle = <0x71>;

				pins_cmd_dat {
					drive-strength = <0x2>;
					pinmux = <0xc401>;
				};
			};

			camera4_mclk_8ma@gpio196 {
				phandle = <0x72>;

				pins_cmd_dat {
					drive-strength = <0x3>;
					pinmux = <0xc401>;
				};
			};

			camera4_mclk_gpio_mode@gpio196 {
				phandle = <0x6e>;

				pins_cmd_dat {
					drive-strength = <0x1>;
					pinmux = <0xc400>;
				};
			};

			camera4_pdn_output_high@gpio115 {
				phandle = <0x45>;

				pins_cmd_dat {
					output-high;
					pinmux = <0x7300>;
				};
			};

			camera4_pdn_output_low@gpio115 {
				phandle = <0x44>;

				pins_cmd_dat {
					output-low;
					pinmux = <0x7300>;
				};
			};

			camera4_rst_output_high@gpio197 {
				phandle = <0x43>;

				pins_cmd_dat {
					output-high;
					pinmux = <0xc500>;
				};
			};

			camera4_rst_output_low@gpio197 {
				phandle = <0x42>;

				pins_cmd_dat {
					output-low;
					pinmux = <0xc500>;
				};
			};

			camera4_vcama_output_high@gpio195 {
				phandle = <0x57>;

				pins_cmd_dat {
					output-high;
					pinmux = <0xc300>;
				};
			};

			camera4_vcama_output_low@gpio195 {
				phandle = <0x56>;

				pins_cmd_dat {
					output-low;
					pinmux = <0xc300>;
				};
			};

			camera4_vcamd_output_high@gpio195 {
				phandle = <0x59>;

				pins_cmd_dat {
					output-high;
					pinmux = <0xc300>;
				};
			};

			camera4_vcamd_output_low@gpio195 {
				phandle = <0x58>;

				pins_cmd_dat {
					output-low;
					pinmux = <0xc300>;
					slew-rate = <0x1>;
				};
			};

			mipi_sel@0 {
				phandle = <0x73>;

				pins_cmd_dat {
					output-low;
					pinmux = <0x5e00>;
					slew-rate = <0x1>;
				};
			};

			mipi_sel@1 {
				phandle = <0x74>;

				pins_cmd_dat {
					output-high;
					pinmux = <0x5e00>;
					slew-rate = <0x1>;
				};
			};
		};
	};

	fragment@53 {
		target = <0xffffffff>;

		__overlay__ {
			cam0_vcamio-supply = <0xffffffff>;
			cam1_vcamio-supply = <0xffffffff>;
			cam2_vcamio-supply = <0xffffffff>;
			cam3_vcamio-supply = <0xffffffff>;
			cam4_vcamio-supply = <0xffffffff>;
			pinctrl-0 = <0x31>;
			pinctrl-1 = <0x32>;
			pinctrl-10 = <0x3b>;
			pinctrl-11 = <0x3c>;
			pinctrl-12 = <0x3d>;
			pinctrl-13 = <0x3e>;
			pinctrl-14 = <0x3f>;
			pinctrl-15 = <0x40>;
			pinctrl-16 = <0x41>;
			pinctrl-17 = <0x42>;
			pinctrl-18 = <0x43>;
			pinctrl-19 = <0x44>;
			pinctrl-2 = <0x33>;
			pinctrl-20 = <0x45>;
			pinctrl-21 = <0x46>;
			pinctrl-22 = <0x47>;
			pinctrl-23 = <0x48>;
			pinctrl-24 = <0x49>;
			pinctrl-25 = <0x4a>;
			pinctrl-26 = <0x4b>;
			pinctrl-27 = <0x4c>;
			pinctrl-28 = <0x4d>;
			pinctrl-29 = <0x4e>;
			pinctrl-3 = <0x34>;
			pinctrl-30 = <0x4f>;
			pinctrl-31 = <0x50>;
			pinctrl-32 = <0x51>;
			pinctrl-33 = <0x52>;
			pinctrl-34 = <0x53>;
			pinctrl-35 = <0x54>;
			pinctrl-36 = <0x55>;
			pinctrl-37 = <0x56>;
			pinctrl-38 = <0x57>;
			pinctrl-39 = <0x58>;
			pinctrl-4 = <0x35>;
			pinctrl-40 = <0x59>;
			pinctrl-41 = <0x5a>;
			pinctrl-42 = <0x5b>;
			pinctrl-43 = <0x5c>;
			pinctrl-44 = <0x5d>;
			pinctrl-45 = <0x5e>;
			pinctrl-46 = <0x5f>;
			pinctrl-47 = <0x60>;
			pinctrl-48 = <0x61>;
			pinctrl-49 = <0x62>;
			pinctrl-5 = <0x36>;
			pinctrl-50 = <0x63>;
			pinctrl-51 = <0x64>;
			pinctrl-52 = <0x65>;
			pinctrl-53 = <0x66>;
			pinctrl-54 = <0x67>;
			pinctrl-55 = <0x68>;
			pinctrl-56 = <0x69>;
			pinctrl-57 = <0x6a>;
			pinctrl-58 = <0x6b>;
			pinctrl-59 = <0x6c>;
			pinctrl-6 = <0x37>;
			pinctrl-60 = <0x6d>;
			pinctrl-61 = <0x6e>;
			pinctrl-62 = <0x6f>;
			pinctrl-63 = <0x70>;
			pinctrl-64 = <0x71>;
			pinctrl-65 = <0x72>;
			pinctrl-66 = <0x73>;
			pinctrl-67 = <0x74>;
			pinctrl-7 = <0x38>;
			pinctrl-8 = <0x39>;
			pinctrl-9 = <0x3a>;
			pinctrl-names = "default", "cam0_rst0", "cam0_rst1", "cam0_pnd0", "cam0_pnd1", "cam1_rst0", "cam1_rst1", "cam1_pnd0", "cam1_pnd1", "cam2_rst0", "cam2_rst1", "cam2_pnd0", "cam2_pnd1", "cam3_rst0", "cam3_rst1", "cam3_pnd0", "cam3_pnd1", "cam4_rst0", "cam4_rst1", "cam4_pnd0", "cam4_pnd1", "cam0_ldo_vcama_0", "cam0_ldo_vcama_1", "cam0_ldo_vcamd_0", "cam0_ldo_vcamd_1", "cam1_ldo_vcama_0", "cam1_ldo_vcama_1", "cam1_ldo_vcamd_0", "cam1_ldo_vcamd_1", "cam2_ldo_vcama_0", "cam2_ldo_vcama_1", "cam2_ldo_vcamd_0", "cam2_ldo_vcamd_1", "cam3_ldo_vcama_0", "cam3_ldo_vcama_1", "cam3_ldo_vcamd_0", "cam3_ldo_vcamd_1", "cam4_ldo_vcama_0", "cam4_ldo_vcama_1", "cam4_ldo_vcamd_0", "cam4_ldo_vcamd_1", "cam0_mclk_off", "cam0_mclk_2mA", "cam0_mclk_4mA", "cam0_mclk_6mA", "cam0_mclk_8mA", "cam1_mclk_off", "cam1_mclk_2mA", "cam1_mclk_4mA", "cam1_mclk_6mA", "cam1_mclk_8mA", "cam2_mclk_off", "cam2_mclk_2mA", "cam2_mclk_4mA", "cam2_mclk_6mA", "cam2_mclk_8mA", "cam3_mclk_off", "cam3_mclk_2mA", "cam3_mclk_4mA", "cam3_mclk_6mA", "cam3_mclk_8mA", "cam4_mclk_off", "cam4_mclk_2mA", "cam4_mclk_4mA", "cam4_mclk_6mA", "cam4_mclk_8mA", "cam_mipi_switch_sel_0", "cam_mipi_switch_sel_1";
			status = "okay";
		};
	};

	fragment@54 {
		target = <0xffffffff>;

		__overlay__ {
			#address-cells = <0x1>;
			#size-cells = <0x0>;

			fingerprint@0 {
				compatible = "goodix,goodix-fp";
				netlink-event = <0x1e>;
				reg = <0x0>;
				spi-max-frequency = <0x7a1200>;
				status = "okay";
			};
		};
	};

	fragment@55 {
		target = <0xffffffff>;

		__overlay__ {
			debounce = <0x4 0x0>;
			fpc,gpio_irq = <0xffffffff 0x4 0x0>;
			interrupt-parent = <0xffffffff>;
			interrupts = <0x4 0x1 0x4 0x0>;
			pinctrl-0 = <0x75>;
			pinctrl-1 = <0x76>;
			pinctrl-2 = <0x77>;
			pinctrl-names = "default", "reset_high", "reset_low";
			status = "okay";
		};
	};

	fragment@56 {
		target = <0xffffffff>;

		__overlay__ {

			state_default {
				phandle = <0x75>;

				pins_cmd_dat {
					bias-disable;
					pinmux = <0x400>;
					slew-rate = <0x0>;
				};
			};

			state_reset_high {
				phandle = <0x76>;

				pins_cmd_dat {
					output-high;
					pinmux = <0x300>;
					slew-rate = <0x1>;
				};
			};

			state_reset_low {
				phandle = <0x77>;

				pins_cmd_dat {
					output-low;
					pinmux = <0x300>;
					slew-rate = <0x1>;
				};
			};
		};
	};

	fragment@57 {
		target = <0xffffffff>;

		__overlay__ {
			#address-cells = <0x1>;
			#size-cells = <0x0>;

			touch_spi@0 {
				compatible = "xiaomi,spi-for-tp";
				reg = <0x0>;
				spi-max-frequency = <0x989680>;
				status = "ok";
			};
		};
	};

	fragment@58 {
		target = <0xffffffff>;

		__overlay__ {

			simtray {
				compatible = "xiaomi,simtray-status";
				status-gpio = <0xffffffff 0x8c 0x0 0xffffffff 0x8d 0x1>;
			};
		};
	};

	fragment@59 {
		target = <0xffffffff>;

		__overlay__ {
			compatible = "focaltech,fts";
			focaltech,display-coords = <0x0 0x0 0x438 0x924>;
			focaltech,irq-gpio = <0xffffffff 0x1 0x2002>;
			focaltech,max-touch-number = <0xa>;
			focaltech,reset-gpio = <0xffffffff 0x2 0x0>;
			spi-max-frequency = <0x44aa20>;
			status = "ok";
		};
	};

	fragment@6 {
		target = <0xffffffff>;

		__overlay__ {

			led@0 {
				compatible = "mediatek,red";
				data = <0x1>;
				led_mode = <0x0>;
				phandle = <0x78>;
				pwm_config = <0x0 0x0 0x0 0x0 0x0>;
			};

			led@1 {
				compatible = "mediatek,green";
				data = <0x1>;
				led_mode = <0x0>;
				phandle = <0x79>;
				pwm_config = <0x0 0x0 0x0 0x0 0x0>;
			};

			led@2 {
				compatible = "mediatek,blue";
				data = <0x1>;
				led_mode = <0x0>;
				phandle = <0x7a>;
				pwm_config = <0x0 0x0 0x0 0x0 0x0>;
			};

			led@3 {
				compatible = "mediatek,jogball-backlight";
				data = <0x1>;
				led_mode = <0x0>;
				phandle = <0x7b>;
				pwm_config = <0x0 0x0 0x0 0x0 0x0>;
			};

			led@4 {
				compatible = "mediatek,keyboard-backlight";
				data = <0x1>;
				led_mode = <0x0>;
				phandle = <0x7c>;
				pwm_config = <0x0 0x0 0x0 0x0 0x0>;
			};

			led@5 {
				compatible = "mediatek,button-backlight";
				data = <0x1>;
				led_mode = <0x0>;
				phandle = <0x7d>;
				pwm_config = <0x0 0x0 0x0 0x0 0x0>;
			};

			led@6 {
				compatible = "mediatek,lcd-backlight";
				data = <0x1>;
				led_bits = <0xb>;
				led_mode = <0x5>;
				phandle = <0x7e>;
				pwm_config = <0x0 0x6 0x0 0x0 0x0>;
			};

			usb_c_pinctrl {
				compatible = "mediatek,usb_c_pinctrl";
				phandle = <0x80>;
				pinctrl-0 = <0xa>;
				pinctrl-1 = <0xb>;
				pinctrl-10 = <0x14>;
				pinctrl-11 = <0x15>;
				pinctrl-12 = <0x16>;
				pinctrl-2 = <0xc>;
				pinctrl-3 = <0xd>;
				pinctrl-4 = <0xe>;
				pinctrl-5 = <0xf>;
				pinctrl-6 = <0x10>;
				pinctrl-7 = <0x11>;
				pinctrl-8 = <0x12>;
				pinctrl-9 = <0x13>;
				pinctrl-names = "usb_default", "redrv_c1_init", "redrv_c1_low", "redrv_c1_hiz", "redrv_c1_high", "redrv_c2_init", "redrv_c2_low", "redrv_c2_hiz", "redrv_c2_high", "switch_sel1", "switch_sel2", "switch_enable", "switch_disable";
				status = "okay";

				usb_switch-data {
					c1_pin_num = <0x1f>;
					c1_pin_val = <0x2>;
					c2_pin_num = <0x1e>;
					c2_pin_val = <0x1>;
					en_pin_num = <0x0>;
					en_pin_val = <0x0>;
					sel_pin_num = <0x20>;
					sel_pin_val = <0x1>;
				};
			};

			vibrator@0 {
				compatible = "mediatek,vibrator";
				phandle = <0x7f>;
				vib_limit = <0x9>;
				vib_timer = <0x19>;
				vib_vol = <0x9>;
			};
		};
	};

	fragment@60 {
		target = <0xffffffff>;

		__overlay__ {
			#address-cells = <0x1>;
			#size-cells = <0x0>;

			p61@31 {
				compatible = "nxp,p61";
				reg = <0x0>;
				spi-max-frequency = <0x7a1200>;
				status = "okay";
			};
		};
	};

	fragment@61 {
		target = <0xffffffff>;

		__overlay__ {
			compatible = "xiaomi-touch";
			status = "ok";
			touch,name = "xiaomi-touch";
		};
	};

	fragment@62 {
		target = <0xffffffff>;

		__overlay__ {
			board-sensor = "VIRTUAL-SENSOR";
		};
	};

	fragment@63 {
		target = <0xffffffff>;

		__overlay__ {

			smb1351-charger@1d {
				charger_name = "secondary_chg";
				compatible = "qcom,smb1351-charger";
				cv = <0x4313e0>;
				en_st;
				en_wdt;
				ichg = <0x1b7740>;
				ieoc = <0x30d40>;
				interrupt-parent = <0xffffffff>;
				interrupts = <0xc 0x2 0xc 0x0>;
				mi,connect_therm = <0xffffffff 0x7f 0x0>;
				mivr = <0x44aa20>;
				qcom,bc12_supported;
				qcom,recharge-disabled;
				qcom,smb1351_susp = <0xffffffff 0x15 0x0>;
				reg = <0x1d>;
				safety_timer = <0xc>;
			};
		};
	};

	fragment@64 {
		target = <0xffffffff>;

		__overlay__ {
			ac_charger_current = <0xf4240>;
			non_std_ac_charger_current = <0x7a120>;
			temp_t1_threshold = <0x0>;
			temp_t3_threshold = <0x2d>;
			temp_t4_threshold = <0x3c>;
		};
	};

	fragment@65 {
		target = <0xffffffff>;

		__overlay__ {
			ac_charger_input_current = <0x1e8480>;
			algorithm_name = "DualSwitchCharging";
			chg1_ta_ac_charger_current = <0x19f0a0>;
			chg1_ta_ac_charger_input_current = <0x13d620>;
			chg2_ta_ac_charger_current = <0x1b7740>;
			chg2_ta_ac_charger_input_current = <0x155cc0>;
			enable_min_charge_temp;
			enable_sw_jeita;
			jeita_temp_above_t4_cv = <0x3e6890>;
			jeita_temp_below_t0_cv = <0x42fc70>;
			jeita_temp_t0_to_t1_cv = <0x42fc70>;
			jeita_temp_t1_to_t2_cv = <0x42fc70>;
			jeita_temp_t2_to_t3_cv = <0x42fc70>;
			jeita_temp_t3_to_t4_cv = <0x3e6890>;
			max_charge_temp = <0x3c>;
			max_charge_temp_minus_x_degree = <0x3a>;
			mi,cycle-count-cv = <0x0 0x63 0x42fc70 0x64 0xc7 0x42ae50 0xc8 0x12b 0x426030 0x12c 0xbb7 0x421210>;
			min_charge_temp = <0x0>;
			min_charge_temp_plus_x_degree = <0x2>;
			non_std_ac_charger_current = <0x7a120>;
			parallel_vbus;
			pd_vbus_upper_bound = <0x895440>;
			pe40_dual_charger_chg1_current = <0x19f0a0>;
			pe40_dual_charger_chg2_current = <0x1b7740>;
			qcom,thermal-mitigation-dcp = <0x1b7740 0x1b7740 0x1b7740 0x1b7740 0x1b7740 0x1b7740 0x1b7740 0x1b7740 0x1b7740 0x1b7740 0x1b7740 0x1b7740 0x186a00 0x155cc0 0x124f80 0xf4240>;
			qcom,thermal-mitigation-pd-base = <0x2dc6c0 0x2ab980 0x27ac40 0x249f00 0x2191c0 0x1e8480 0x1b7740 0x186a00 0x186a00 0x155cc0 0x124f80 0x10c8e0 0xf4240 0xdbba0 0xb7b74 0x802c8>;
			qcom,thermal-mitigation-qc2 = <0x18cba8 0x18cba8 0x18cba8 0x18cba8 0x18cba8 0x174508 0x15be68 0x1437c8 0x12b128 0x112a88 0xfa5dc 0xe1d48 0xc96a8 0xb1008 0x98968 0x802c8>;
			qcom,thermal-mitigation-qc3 = <0x2932e0 0x273710 0x249f00 0x22a330 0x205940 0x1dfbc8 0x1bc560 0x192d50 0x16e360 0x14fb18 0x12b128 0x10c8e0 0xee098 0xc96a8 0xa4cb8 0x73f78>;
			set_cap_delay = <0xa>;
			temp_neg_10_thres = <0x0>;
			temp_t0_thres = <0x0>;
			temp_t0_thres_plus_x_degree = <0x0>;
			temp_t1_thres = <0x5>;
			temp_t1_thres_plus_x_degree = <0x2>;
			temp_t2_thres = <0xf>;
			temp_t2_thres_plus_x_degree = <0xd>;
			temp_t3_thres = <0x2d>;
			temp_t3_thres_minus_x_degree = <0x2b>;
			temp_t4_thres = <0x3c>;
			temp_t4_thres_minus_x_degree = <0x3a>;
		};
	};

	fragment@66 {
		target = <0xffffffff>;

		__overlay__ {

			usb_phy_tuning {
				compatible = "mediatek,phy_tuning";
				u2_enhance = <0x1>;
				u2_term_ref = <0x4>;
				u2_vrt_ref = <0x4>;
			};
		};
	};

	fragment@7 {
		target = <0xffffffff>;

		__overlay__ {

			lcd_bias_enn0_gpio {
				phandle = <0x1a>;

				pins_cmd_dat {
					output-low;
					pinmux = <0xca00>;
					slew-rate = <0x1>;
				};
			};

			lcd_bias_enn1_gpio {
				phandle = <0x19>;

				pins_cmd_dat {
					output-high;
					pinmux = <0xca00>;
					slew-rate = <0x1>;
				};
			};

			lcd_bias_enp0_gpio {
				phandle = <0x18>;

				pins_cmd_dat {
					output-low;
					pinmux = <0x1700>;
					slew-rate = <0x1>;
				};
			};

			lcd_bias_enp1_gpio {
				phandle = <0x17>;

				pins_cmd_dat {
					output-high;
					pinmux = <0x1700>;
					slew-rate = <0x1>;
				};
			};

			lcd_bl_bias_en0_gpio {
				phandle = <0x1f>;

				pins_cmd_dat {
					output-low;
					pinmux = <0x1600>;
					slew-rate = <0x1>;
				};
			};

			lcd_bl_bias_en1_gpio {
				phandle = <0x1e>;

				pins_cmd_dat {
					output-high;
					pinmux = <0x1600>;
					slew-rate = <0x1>;
				};
			};

			lcm_dsi_te {
				phandle = <0x1d>;

				pins_cmd_dat {
					pinmux = <0x2b01>;
				};
			};

			lcm_rst_out0_gpio {
				phandle = <0x1c>;

				pins_cmd_dat {
					output-low;
					pinmux = <0x2c00>;
					slew-rate = <0x1>;
				};
			};

			lcm_rst_out1_gpio {
				phandle = <0x1b>;

				pins_cmd_dat {
					output-high;
					pinmux = <0x2c00>;
					slew-rate = <0x1>;
				};
			};
		};
	};

	fragment@8 {
		target = <0xffffffff>;

		__overlay__ {
			pinctrl-0 = <0x17>;
			pinctrl-1 = <0x18>;
			pinctrl-2 = <0x19>;
			pinctrl-3 = <0x1a>;
			pinctrl-4 = <0x1b>;
			pinctrl-5 = <0x1c>;
			pinctrl-6 = <0x1d>;
			pinctrl-7 = <0x1e>;
			pinctrl-8 = <0x1f>;
			pinctrl-names = "lcd_bias_enp1_gpio", "lcd_bias_enp0_gpio", "lcd_bias_enn1_gpio", "lcd_bias_enn0_gpio", "lcm_rst_out1_gpio", "lcm_rst_out0_gpio", "mode_te_te", "lcd_bl_bias_en1", "lcd_bl_bias_en0";
			status = "okay";
		};
	};

	fragment@9 {
		target = <0xffffffff>;

		__overlay__ {
			mt6360,intr_gpio = <0xffffffff 0x10 0x0>;
			mt6360,intr_gpio_num = <0x10>;
		};
	};
};
